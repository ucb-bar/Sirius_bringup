// Generated by CIRCT firtool-1.66.0
// Standard header to adapt well known macros for register randomization.
`ifndef RANDOMIZE
  `ifdef RANDOMIZE_MEM_INIT
    `define RANDOMIZE
  `endif // RANDOMIZE_MEM_INIT
`endif // not def RANDOMIZE
`ifndef RANDOMIZE
  `ifdef RANDOMIZE_REG_INIT
    `define RANDOMIZE
  `endif // RANDOMIZE_REG_INIT
`endif // not def RANDOMIZE

// RANDOM may be set to an expression that produces a 32-bit random unsigned value.
`ifndef RANDOM
  `define RANDOM $random
`endif // not def RANDOM

// Users can define INIT_RANDOM as general code that gets injected into the
// initializer block for modules with registers.
`ifndef INIT_RANDOM
  `define INIT_RANDOM
`endif // not def INIT_RANDOM

// If using random initialization, you can also define RANDOMIZE_DELAY to
// customize the delay used, otherwise 0.002 is used.
`ifndef RANDOMIZE_DELAY
  `define RANDOMIZE_DELAY 0.002
`endif // not def RANDOMIZE_DELAY

// Define INIT_RANDOM_PROLOG_ for use in our modules below.
`ifndef INIT_RANDOM_PROLOG_
  `ifdef RANDOMIZE
    `ifdef VERILATOR
      `define INIT_RANDOM_PROLOG_ `INIT_RANDOM
    `else  // VERILATOR
      `define INIT_RANDOM_PROLOG_ `INIT_RANDOM #`RANDOMIZE_DELAY begin end
    `endif // VERILATOR
  `else  // RANDOMIZE
    `define INIT_RANDOM_PROLOG_
  `endif // RANDOMIZE
`endif // not def INIT_RANDOM_PROLOG_

// Include register initializers in init blocks unless synthesis is set
`ifndef SYNTHESIS
  `ifndef ENABLE_INITIAL_REG_
    `define ENABLE_INITIAL_REG_
  `endif // not def ENABLE_INITIAL_REG_
`endif // not def SYNTHESIS

// Include rmemory initializers in init blocks unless synthesis is set
`ifndef SYNTHESIS
  `ifndef ENABLE_INITIAL_MEM_
    `define ENABLE_INITIAL_MEM_
  `endif // not def ENABLE_INITIAL_MEM_
`endif // not def SYNTHESIS

// Standard header to adapt well known macros for prints and assertions.

// Users can define 'PRINTF_COND' to add an extra gate to prints.
`ifndef PRINTF_COND_
  `ifdef PRINTF_COND
    `define PRINTF_COND_ (`PRINTF_COND)
  `else  // PRINTF_COND
    `define PRINTF_COND_ 1
  `endif // PRINTF_COND
`endif // not def PRINTF_COND_

// Users can define 'ASSERT_VERBOSE_COND' to add an extra gate to assert error printing.
`ifndef ASSERT_VERBOSE_COND_
  `ifdef ASSERT_VERBOSE_COND
    `define ASSERT_VERBOSE_COND_ (`ASSERT_VERBOSE_COND)
  `else  // ASSERT_VERBOSE_COND
    `define ASSERT_VERBOSE_COND_ 1
  `endif // ASSERT_VERBOSE_COND
`endif // not def ASSERT_VERBOSE_COND_

// Users can define 'STOP_COND' to add an extra gate to stop conditions.
`ifndef STOP_COND_
  `ifdef STOP_COND
    `define STOP_COND_ (`STOP_COND)
  `else  // STOP_COND
    `define STOP_COND_ 1
  `endif // STOP_COND
`endif // not def STOP_COND_

module TLBroadcast(
  input         clock,
  input         reset,
  output        auto_in_a_ready,	// @[generators/diplomacy/diplomacy/src/diplomacy/lazymodule/LazyModuleImp.scala:100:25]
  input         auto_in_a_valid,	// @[generators/diplomacy/diplomacy/src/diplomacy/lazymodule/LazyModuleImp.scala:100:25]
  input  [2:0]  auto_in_a_bits_opcode,	// @[generators/diplomacy/diplomacy/src/diplomacy/lazymodule/LazyModuleImp.scala:100:25]
  input  [2:0]  auto_in_a_bits_param,	// @[generators/diplomacy/diplomacy/src/diplomacy/lazymodule/LazyModuleImp.scala:100:25]
  input  [2:0]  auto_in_a_bits_size,	// @[generators/diplomacy/diplomacy/src/diplomacy/lazymodule/LazyModuleImp.scala:100:25]
  input  [8:0]  auto_in_a_bits_source,	// @[generators/diplomacy/diplomacy/src/diplomacy/lazymodule/LazyModuleImp.scala:100:25]
  input  [31:0] auto_in_a_bits_address,	// @[generators/diplomacy/diplomacy/src/diplomacy/lazymodule/LazyModuleImp.scala:100:25]
  input  [7:0]  auto_in_a_bits_mask,	// @[generators/diplomacy/diplomacy/src/diplomacy/lazymodule/LazyModuleImp.scala:100:25]
  input  [63:0] auto_in_a_bits_data,	// @[generators/diplomacy/diplomacy/src/diplomacy/lazymodule/LazyModuleImp.scala:100:25]
  input         auto_in_d_ready,	// @[generators/diplomacy/diplomacy/src/diplomacy/lazymodule/LazyModuleImp.scala:100:25]
  output        auto_in_d_valid,	// @[generators/diplomacy/diplomacy/src/diplomacy/lazymodule/LazyModuleImp.scala:100:25]
  output [2:0]  auto_in_d_bits_opcode,	// @[generators/diplomacy/diplomacy/src/diplomacy/lazymodule/LazyModuleImp.scala:100:25]
  output [1:0]  auto_in_d_bits_param,	// @[generators/diplomacy/diplomacy/src/diplomacy/lazymodule/LazyModuleImp.scala:100:25]
  output [2:0]  auto_in_d_bits_size,	// @[generators/diplomacy/diplomacy/src/diplomacy/lazymodule/LazyModuleImp.scala:100:25]
  output [8:0]  auto_in_d_bits_source,	// @[generators/diplomacy/diplomacy/src/diplomacy/lazymodule/LazyModuleImp.scala:100:25]
  output [1:0]  auto_in_d_bits_sink,	// @[generators/diplomacy/diplomacy/src/diplomacy/lazymodule/LazyModuleImp.scala:100:25]
  output        auto_in_d_bits_denied,	// @[generators/diplomacy/diplomacy/src/diplomacy/lazymodule/LazyModuleImp.scala:100:25]
  output [63:0] auto_in_d_bits_data,	// @[generators/diplomacy/diplomacy/src/diplomacy/lazymodule/LazyModuleImp.scala:100:25]
  output        auto_in_d_bits_corrupt,	// @[generators/diplomacy/diplomacy/src/diplomacy/lazymodule/LazyModuleImp.scala:100:25]
  input         auto_out_a_ready,	// @[generators/diplomacy/diplomacy/src/diplomacy/lazymodule/LazyModuleImp.scala:100:25]
  output        auto_out_a_valid,	// @[generators/diplomacy/diplomacy/src/diplomacy/lazymodule/LazyModuleImp.scala:100:25]
  output [2:0]  auto_out_a_bits_opcode,	// @[generators/diplomacy/diplomacy/src/diplomacy/lazymodule/LazyModuleImp.scala:100:25]
  output [2:0]  auto_out_a_bits_param,	// @[generators/diplomacy/diplomacy/src/diplomacy/lazymodule/LazyModuleImp.scala:100:25]
  output [2:0]  auto_out_a_bits_size,	// @[generators/diplomacy/diplomacy/src/diplomacy/lazymodule/LazyModuleImp.scala:100:25]
  output [10:0] auto_out_a_bits_source,	// @[generators/diplomacy/diplomacy/src/diplomacy/lazymodule/LazyModuleImp.scala:100:25]
  output [31:0] auto_out_a_bits_address,	// @[generators/diplomacy/diplomacy/src/diplomacy/lazymodule/LazyModuleImp.scala:100:25]
  output [7:0]  auto_out_a_bits_mask,	// @[generators/diplomacy/diplomacy/src/diplomacy/lazymodule/LazyModuleImp.scala:100:25]
  output [63:0] auto_out_a_bits_data,	// @[generators/diplomacy/diplomacy/src/diplomacy/lazymodule/LazyModuleImp.scala:100:25]
  output        auto_out_d_ready,	// @[generators/diplomacy/diplomacy/src/diplomacy/lazymodule/LazyModuleImp.scala:100:25]
  input         auto_out_d_valid,	// @[generators/diplomacy/diplomacy/src/diplomacy/lazymodule/LazyModuleImp.scala:100:25]
  input  [2:0]  auto_out_d_bits_opcode,	// @[generators/diplomacy/diplomacy/src/diplomacy/lazymodule/LazyModuleImp.scala:100:25]
  input  [1:0]  auto_out_d_bits_param,	// @[generators/diplomacy/diplomacy/src/diplomacy/lazymodule/LazyModuleImp.scala:100:25]
  input  [2:0]  auto_out_d_bits_size,	// @[generators/diplomacy/diplomacy/src/diplomacy/lazymodule/LazyModuleImp.scala:100:25]
  input  [10:0] auto_out_d_bits_source,	// @[generators/diplomacy/diplomacy/src/diplomacy/lazymodule/LazyModuleImp.scala:100:25]
  input         auto_out_d_bits_denied,	// @[generators/diplomacy/diplomacy/src/diplomacy/lazymodule/LazyModuleImp.scala:100:25]
  input  [63:0] auto_out_d_bits_data,	// @[generators/diplomacy/diplomacy/src/diplomacy/lazymodule/LazyModuleImp.scala:100:25]
  input         auto_out_d_bits_corrupt	// @[generators/diplomacy/diplomacy/src/diplomacy/lazymodule/LazyModuleImp.scala:100:25]
);

  wire        d_normal_ready;	// @[generators/rocket-chip/src/main/scala/tilelink/Arbiter.scala:94:31]
  wire [2:0]  d_normal_bits_opcode;	// @[generators/rocket-chip/src/main/scala/tilelink/Broadcast.scala:136:21, :137:24, :138:30]
  wire [8:0]  d_normal_bits_source;	// @[generators/rocket-chip/src/main/scala/tilelink/Broadcast.scala:136:21]
  wire        winner_1;	// @[generators/rocket-chip/src/main/scala/tilelink/Broadcast.scala:135:48]
  wire        _TLBroadcastTracker_3_io_in_a_ready;	// @[generators/rocket-chip/src/main/scala/tilelink/Broadcast.scala:113:15]
  wire        _TLBroadcastTracker_3_io_out_a_valid;	// @[generators/rocket-chip/src/main/scala/tilelink/Broadcast.scala:113:15]
  wire [2:0]  _TLBroadcastTracker_3_io_out_a_bits_opcode;	// @[generators/rocket-chip/src/main/scala/tilelink/Broadcast.scala:113:15]
  wire [2:0]  _TLBroadcastTracker_3_io_out_a_bits_param;	// @[generators/rocket-chip/src/main/scala/tilelink/Broadcast.scala:113:15]
  wire [2:0]  _TLBroadcastTracker_3_io_out_a_bits_size;	// @[generators/rocket-chip/src/main/scala/tilelink/Broadcast.scala:113:15]
  wire [10:0] _TLBroadcastTracker_3_io_out_a_bits_source;	// @[generators/rocket-chip/src/main/scala/tilelink/Broadcast.scala:113:15]
  wire [31:0] _TLBroadcastTracker_3_io_out_a_bits_address;	// @[generators/rocket-chip/src/main/scala/tilelink/Broadcast.scala:113:15]
  wire [7:0]  _TLBroadcastTracker_3_io_out_a_bits_mask;	// @[generators/rocket-chip/src/main/scala/tilelink/Broadcast.scala:113:15]
  wire [63:0] _TLBroadcastTracker_3_io_out_a_bits_data;	// @[generators/rocket-chip/src/main/scala/tilelink/Broadcast.scala:113:15]
  wire [8:0]  _TLBroadcastTracker_3_io_source;	// @[generators/rocket-chip/src/main/scala/tilelink/Broadcast.scala:113:15]
  wire [25:0] _TLBroadcastTracker_3_io_line;	// @[generators/rocket-chip/src/main/scala/tilelink/Broadcast.scala:113:15]
  wire        _TLBroadcastTracker_3_io_idle;	// @[generators/rocket-chip/src/main/scala/tilelink/Broadcast.scala:113:15]
  wire        _TLBroadcastTracker_3_io_need_d;	// @[generators/rocket-chip/src/main/scala/tilelink/Broadcast.scala:113:15]
  wire        _TLBroadcastTracker_2_io_in_a_ready;	// @[generators/rocket-chip/src/main/scala/tilelink/Broadcast.scala:113:15]
  wire        _TLBroadcastTracker_2_io_out_a_valid;	// @[generators/rocket-chip/src/main/scala/tilelink/Broadcast.scala:113:15]
  wire [2:0]  _TLBroadcastTracker_2_io_out_a_bits_opcode;	// @[generators/rocket-chip/src/main/scala/tilelink/Broadcast.scala:113:15]
  wire [2:0]  _TLBroadcastTracker_2_io_out_a_bits_param;	// @[generators/rocket-chip/src/main/scala/tilelink/Broadcast.scala:113:15]
  wire [2:0]  _TLBroadcastTracker_2_io_out_a_bits_size;	// @[generators/rocket-chip/src/main/scala/tilelink/Broadcast.scala:113:15]
  wire [10:0] _TLBroadcastTracker_2_io_out_a_bits_source;	// @[generators/rocket-chip/src/main/scala/tilelink/Broadcast.scala:113:15]
  wire [31:0] _TLBroadcastTracker_2_io_out_a_bits_address;	// @[generators/rocket-chip/src/main/scala/tilelink/Broadcast.scala:113:15]
  wire [7:0]  _TLBroadcastTracker_2_io_out_a_bits_mask;	// @[generators/rocket-chip/src/main/scala/tilelink/Broadcast.scala:113:15]
  wire [63:0] _TLBroadcastTracker_2_io_out_a_bits_data;	// @[generators/rocket-chip/src/main/scala/tilelink/Broadcast.scala:113:15]
  wire [8:0]  _TLBroadcastTracker_2_io_source;	// @[generators/rocket-chip/src/main/scala/tilelink/Broadcast.scala:113:15]
  wire [25:0] _TLBroadcastTracker_2_io_line;	// @[generators/rocket-chip/src/main/scala/tilelink/Broadcast.scala:113:15]
  wire        _TLBroadcastTracker_2_io_idle;	// @[generators/rocket-chip/src/main/scala/tilelink/Broadcast.scala:113:15]
  wire        _TLBroadcastTracker_2_io_need_d;	// @[generators/rocket-chip/src/main/scala/tilelink/Broadcast.scala:113:15]
  wire        _TLBroadcastTracker_1_io_in_a_ready;	// @[generators/rocket-chip/src/main/scala/tilelink/Broadcast.scala:113:15]
  wire        _TLBroadcastTracker_1_io_out_a_valid;	// @[generators/rocket-chip/src/main/scala/tilelink/Broadcast.scala:113:15]
  wire [2:0]  _TLBroadcastTracker_1_io_out_a_bits_opcode;	// @[generators/rocket-chip/src/main/scala/tilelink/Broadcast.scala:113:15]
  wire [2:0]  _TLBroadcastTracker_1_io_out_a_bits_param;	// @[generators/rocket-chip/src/main/scala/tilelink/Broadcast.scala:113:15]
  wire [2:0]  _TLBroadcastTracker_1_io_out_a_bits_size;	// @[generators/rocket-chip/src/main/scala/tilelink/Broadcast.scala:113:15]
  wire [10:0] _TLBroadcastTracker_1_io_out_a_bits_source;	// @[generators/rocket-chip/src/main/scala/tilelink/Broadcast.scala:113:15]
  wire [31:0] _TLBroadcastTracker_1_io_out_a_bits_address;	// @[generators/rocket-chip/src/main/scala/tilelink/Broadcast.scala:113:15]
  wire [7:0]  _TLBroadcastTracker_1_io_out_a_bits_mask;	// @[generators/rocket-chip/src/main/scala/tilelink/Broadcast.scala:113:15]
  wire [63:0] _TLBroadcastTracker_1_io_out_a_bits_data;	// @[generators/rocket-chip/src/main/scala/tilelink/Broadcast.scala:113:15]
  wire [8:0]  _TLBroadcastTracker_1_io_source;	// @[generators/rocket-chip/src/main/scala/tilelink/Broadcast.scala:113:15]
  wire [25:0] _TLBroadcastTracker_1_io_line;	// @[generators/rocket-chip/src/main/scala/tilelink/Broadcast.scala:113:15]
  wire        _TLBroadcastTracker_1_io_idle;	// @[generators/rocket-chip/src/main/scala/tilelink/Broadcast.scala:113:15]
  wire        _TLBroadcastTracker_1_io_need_d;	// @[generators/rocket-chip/src/main/scala/tilelink/Broadcast.scala:113:15]
  wire        _TLBroadcastTracker_io_in_a_ready;	// @[generators/rocket-chip/src/main/scala/tilelink/Broadcast.scala:113:15]
  wire        _TLBroadcastTracker_io_out_a_valid;	// @[generators/rocket-chip/src/main/scala/tilelink/Broadcast.scala:113:15]
  wire [2:0]  _TLBroadcastTracker_io_out_a_bits_opcode;	// @[generators/rocket-chip/src/main/scala/tilelink/Broadcast.scala:113:15]
  wire [2:0]  _TLBroadcastTracker_io_out_a_bits_param;	// @[generators/rocket-chip/src/main/scala/tilelink/Broadcast.scala:113:15]
  wire [2:0]  _TLBroadcastTracker_io_out_a_bits_size;	// @[generators/rocket-chip/src/main/scala/tilelink/Broadcast.scala:113:15]
  wire [10:0] _TLBroadcastTracker_io_out_a_bits_source;	// @[generators/rocket-chip/src/main/scala/tilelink/Broadcast.scala:113:15]
  wire [31:0] _TLBroadcastTracker_io_out_a_bits_address;	// @[generators/rocket-chip/src/main/scala/tilelink/Broadcast.scala:113:15]
  wire [7:0]  _TLBroadcastTracker_io_out_a_bits_mask;	// @[generators/rocket-chip/src/main/scala/tilelink/Broadcast.scala:113:15]
  wire [63:0] _TLBroadcastTracker_io_out_a_bits_data;	// @[generators/rocket-chip/src/main/scala/tilelink/Broadcast.scala:113:15]
  wire [8:0]  _TLBroadcastTracker_io_source;	// @[generators/rocket-chip/src/main/scala/tilelink/Broadcast.scala:113:15]
  wire [25:0] _TLBroadcastTracker_io_line;	// @[generators/rocket-chip/src/main/scala/tilelink/Broadcast.scala:113:15]
  wire        _TLBroadcastTracker_io_idle;	// @[generators/rocket-chip/src/main/scala/tilelink/Broadcast.scala:113:15]
  wire        _TLBroadcastTracker_io_need_d;	// @[generators/rocket-chip/src/main/scala/tilelink/Broadcast.scala:113:15]
  wire        d_drop = auto_out_d_bits_source[10:9] == 2'h1;	// @[generators/rocket-chip/src/main/scala/tilelink/Broadcast.scala:124:37, :125:27]
  wire        _GEN = d_normal_ready & winner_1;	// @[generators/rocket-chip/src/main/scala/tilelink/Arbiter.scala:94:31, generators/rocket-chip/src/main/scala/tilelink/Broadcast.scala:135:48, src/main/scala/chisel3/util/Decoupled.scala:52:35]
  wire [12:0] _GEN_0 = {10'h0, auto_out_d_bits_size};	// @[generators/rocket-chip/src/main/scala/util/package.scala:243:71]
  wire [12:0] _beats1_decode_T_1 = 13'h3F << _GEN_0;	// @[generators/rocket-chip/src/main/scala/util/package.scala:243:71]
  wire [2:0]  beats1 = d_normal_bits_opcode[0] ? ~(_beats1_decode_T_1[5:3]) : 3'h0;	// @[generators/rocket-chip/src/main/scala/tilelink/Broadcast.scala:136:21, :137:24, :138:30, generators/rocket-chip/src/main/scala/tilelink/Edges.scala:106:36, :221:14, generators/rocket-chip/src/main/scala/util/package.scala:243:{46,71,76}]
  reg  [2:0]  counter;	// @[generators/rocket-chip/src/main/scala/tilelink/Edges.scala:229:27]
  wire        d_first = counter == 3'h0;	// @[generators/rocket-chip/src/main/scala/tilelink/Edges.scala:229:27, :231:25]
  wire        d_last = counter == 3'h1 | beats1 == 3'h0;	// @[generators/rocket-chip/src/main/scala/tilelink/Edges.scala:221:14, :229:27, :232:{25,33,43}]
  wire [3:0]  _d_trackerOH_T_8 = {_TLBroadcastTracker_3_io_need_d & _TLBroadcastTracker_3_io_source == d_normal_bits_source, _TLBroadcastTracker_2_io_need_d & _TLBroadcastTracker_2_io_source == d_normal_bits_source, _TLBroadcastTracker_1_io_need_d & _TLBroadcastTracker_1_io_source == d_normal_bits_source, _TLBroadcastTracker_io_need_d & _TLBroadcastTracker_io_source == d_normal_bits_source};	// @[generators/rocket-chip/src/main/scala/tilelink/Broadcast.scala:113:15, :129:{62,74,102}, :136:21]
  reg  [3:0]  d_trackerOH_r;	// @[generators/rocket-chip/src/main/scala/util/package.scala:88:63]
  wire [3:0]  d_trackerOH = d_first ? _d_trackerOH_T_8 : d_trackerOH_r;	// @[generators/rocket-chip/src/main/scala/tilelink/Broadcast.scala:129:102, generators/rocket-chip/src/main/scala/tilelink/Edges.scala:231:25, generators/rocket-chip/src/main/scala/util/package.scala:88:{42,63}]
  wire        nodeOut_d_ready = d_normal_ready | d_drop;	// @[generators/rocket-chip/src/main/scala/tilelink/Arbiter.scala:94:31, generators/rocket-chip/src/main/scala/tilelink/Broadcast.scala:125:27, :134:50]
  assign winner_1 = auto_out_d_valid & ~d_drop;	// @[generators/rocket-chip/src/main/scala/tilelink/Broadcast.scala:125:27, :131:31, :135:48]
  assign d_normal_bits_source = auto_out_d_bits_source[8:0];	// @[generators/rocket-chip/src/main/scala/tilelink/Broadcast.scala:136:21]
  assign d_normal_bits_opcode = auto_out_d_bits_source[10] ? (auto_out_d_bits_opcode[0] ? 3'h5 : 3'h6) : auto_out_d_bits_opcode;	// @[generators/rocket-chip/src/main/scala/tilelink/Broadcast.scala:124:37, :136:21, :137:{19,24}, :138:{30,36}, generators/rocket-chip/src/main/scala/tilelink/Edges.scala:106:36]
  wire        d_response = auto_out_d_bits_opcode[0] | ~(auto_out_d_bits_source[10]);	// @[generators/rocket-chip/src/main/scala/tilelink/Broadcast.scala:124:37, :137:19, :146:{34,37}, generators/rocket-chip/src/main/scala/tilelink/Edges.scala:106:36]
  wire        _GEN_1 = nodeOut_d_ready & auto_out_d_valid;	// @[generators/rocket-chip/src/main/scala/tilelink/Broadcast.scala:134:50, src/main/scala/chisel3/util/Decoupled.scala:52:35]
  reg  [2:0]  beatsLeft;	// @[generators/rocket-chip/src/main/scala/tilelink/Arbiter.scala:60:30]
  wire        idle = beatsLeft == 3'h0;	// @[generators/rocket-chip/src/main/scala/tilelink/Arbiter.scala:60:30, :61:28]
  reg         state_1;	// @[generators/rocket-chip/src/main/scala/tilelink/Arbiter.scala:88:26]
  wire        muxState_1 = idle ? winner_1 : state_1;	// @[generators/rocket-chip/src/main/scala/tilelink/Arbiter.scala:61:28, :88:26, :89:25, generators/rocket-chip/src/main/scala/tilelink/Broadcast.scala:135:48]
  assign d_normal_ready = auto_in_d_ready & (idle | state_1);	// @[generators/rocket-chip/src/main/scala/tilelink/Arbiter.scala:61:28, :88:26, :92:24, :94:31]
  wire        nodeIn_d_valid = (idle | state_1) & winner_1;	// @[generators/rocket-chip/src/main/scala/tilelink/Arbiter.scala:61:28, :88:26, :96:24, generators/rocket-chip/src/main/scala/tilelink/Broadcast.scala:135:48]
  reg  [2:0]  beatsLeft_1;	// @[generators/rocket-chip/src/main/scala/tilelink/Arbiter.scala:60:30]
  wire        idle_1 = beatsLeft_1 == 3'h0;	// @[generators/rocket-chip/src/main/scala/tilelink/Arbiter.scala:60:30, :61:28]
  wire        _GEN_2 = _TLBroadcastTracker_1_io_out_a_valid | _TLBroadcastTracker_io_out_a_valid;	// @[generators/rocket-chip/src/main/scala/tilelink/Broadcast.scala:113:15, generators/rocket-chip/src/main/scala/util/package.scala:253:43]
  wire        _GEN_3 = _TLBroadcastTracker_2_io_out_a_valid | _TLBroadcastTracker_1_io_out_a_valid | _TLBroadcastTracker_io_out_a_valid;	// @[generators/rocket-chip/src/main/scala/tilelink/Broadcast.scala:113:15, generators/rocket-chip/src/main/scala/util/package.scala:253:43]
  wire        winner_1_2 = ~_TLBroadcastTracker_io_out_a_valid & _TLBroadcastTracker_1_io_out_a_valid;	// @[generators/rocket-chip/src/main/scala/tilelink/Arbiter.scala:16:61, :71:69, generators/rocket-chip/src/main/scala/tilelink/Broadcast.scala:113:15]
  wire        winner_1_3 = ~_GEN_2 & _TLBroadcastTracker_2_io_out_a_valid;	// @[generators/rocket-chip/src/main/scala/tilelink/Arbiter.scala:16:61, :71:69, generators/rocket-chip/src/main/scala/tilelink/Broadcast.scala:113:15, generators/rocket-chip/src/main/scala/util/package.scala:253:43]
  wire        winner_1_4 = ~_GEN_3 & _TLBroadcastTracker_3_io_out_a_valid;	// @[generators/rocket-chip/src/main/scala/tilelink/Arbiter.scala:16:61, :71:69, generators/rocket-chip/src/main/scala/tilelink/Broadcast.scala:113:15, generators/rocket-chip/src/main/scala/util/package.scala:253:43]
  `ifndef SYNTHESIS	// @[generators/rocket-chip/src/main/scala/tilelink/Broadcast.scala:131:14]
    wire prefixOR_3 = _TLBroadcastTracker_io_out_a_valid | winner_1_2;	// @[generators/rocket-chip/src/main/scala/tilelink/Arbiter.scala:71:69, :76:48, generators/rocket-chip/src/main/scala/tilelink/Broadcast.scala:113:15]
    always @(posedge clock) begin	// @[generators/rocket-chip/src/main/scala/tilelink/Broadcast.scala:131:14]
      if (~reset & ~(~auto_out_d_valid | ~d_drop | auto_out_d_bits_opcode == 3'h0)) begin	// @[generators/rocket-chip/src/main/scala/tilelink/Broadcast.scala:125:27, :131:{14,15,28,31,39,60}]
        if (`ASSERT_VERBOSE_COND_)	// @[generators/rocket-chip/src/main/scala/tilelink/Broadcast.scala:131:14]
          $error("Assertion failed\n    at Broadcast.scala:131 assert (!out.d.valid || !d_drop || out.d.bits.opcode === TLMessages.AccessAck)\n");	// @[generators/rocket-chip/src/main/scala/tilelink/Broadcast.scala:131:14]
        if (`STOP_COND_)	// @[generators/rocket-chip/src/main/scala/tilelink/Broadcast.scala:131:14]
          $fatal;	// @[generators/rocket-chip/src/main/scala/tilelink/Broadcast.scala:131:14]
      end
      if (~reset & ~(~winner_1 | (|d_trackerOH) | d_normal_bits_opcode == 3'h6)) begin	// @[generators/rocket-chip/src/main/scala/tilelink/Broadcast.scala:131:14, :135:48, :136:21, :137:24, :138:30, :143:{14,15,31,47,51,75}, generators/rocket-chip/src/main/scala/util/package.scala:88:42]
        if (`ASSERT_VERBOSE_COND_)	// @[generators/rocket-chip/src/main/scala/tilelink/Broadcast.scala:143:14]
          $error("Assertion failed\n    at Broadcast.scala:143 assert (!d_normal.valid || (d_trackerOH.orR || d_normal.bits.opcode === TLMessages.ReleaseAck))\n");	// @[generators/rocket-chip/src/main/scala/tilelink/Broadcast.scala:143:14]
        if (`STOP_COND_)	// @[generators/rocket-chip/src/main/scala/tilelink/Broadcast.scala:143:14]
          $fatal;	// @[generators/rocket-chip/src/main/scala/tilelink/Broadcast.scala:143:14]
      end
      if (~reset & ~((~_TLBroadcastTracker_io_out_a_valid | ~winner_1_2) & (~prefixOR_3 | ~winner_1_3) & (~(prefixOR_3 | winner_1_3) | ~winner_1_4))) begin	// @[generators/rocket-chip/src/main/scala/tilelink/Arbiter.scala:71:69, :76:48, :77:{13,56,59,62,77}, generators/rocket-chip/src/main/scala/tilelink/Broadcast.scala:113:15, :131:14]
        if (`ASSERT_VERBOSE_COND_)	// @[generators/rocket-chip/src/main/scala/tilelink/Arbiter.scala:77:13]
          $error("Assertion failed\n    at Arbiter.scala:77 assert((prefixOR zip winner) map { case (p,w) => !p || !w } reduce {_ && _})\n");	// @[generators/rocket-chip/src/main/scala/tilelink/Arbiter.scala:77:13]
        if (`STOP_COND_)	// @[generators/rocket-chip/src/main/scala/tilelink/Arbiter.scala:77:13]
          $fatal;	// @[generators/rocket-chip/src/main/scala/tilelink/Arbiter.scala:77:13]
      end
      if (~reset & ~(~(_TLBroadcastTracker_io_out_a_valid | _TLBroadcastTracker_1_io_out_a_valid | _TLBroadcastTracker_2_io_out_a_valid | _TLBroadcastTracker_3_io_out_a_valid) | _TLBroadcastTracker_io_out_a_valid | winner_1_2 | winner_1_3 | winner_1_4)) begin	// @[generators/rocket-chip/src/main/scala/tilelink/Arbiter.scala:71:69, :79:{14,15,31,36,54}, generators/rocket-chip/src/main/scala/tilelink/Broadcast.scala:113:15, :131:14]
        if (`ASSERT_VERBOSE_COND_)	// @[generators/rocket-chip/src/main/scala/tilelink/Arbiter.scala:79:14]
          $error("Assertion failed\n    at Arbiter.scala:79 assert (!valids.reduce(_||_) || winner.reduce(_||_))\n");	// @[generators/rocket-chip/src/main/scala/tilelink/Arbiter.scala:79:14]
        if (`STOP_COND_)	// @[generators/rocket-chip/src/main/scala/tilelink/Arbiter.scala:79:14]
          $fatal;	// @[generators/rocket-chip/src/main/scala/tilelink/Arbiter.scala:79:14]
      end
    end // always @(posedge)
  `endif // not def SYNTHESIS
  reg         state_1_1;	// @[generators/rocket-chip/src/main/scala/tilelink/Arbiter.scala:88:26]
  reg         state_1_2;	// @[generators/rocket-chip/src/main/scala/tilelink/Arbiter.scala:88:26]
  reg         state_1_3;	// @[generators/rocket-chip/src/main/scala/tilelink/Arbiter.scala:88:26]
  reg         state_1_4;	// @[generators/rocket-chip/src/main/scala/tilelink/Arbiter.scala:88:26]
  wire        muxState_1_1 = idle_1 ? _TLBroadcastTracker_io_out_a_valid : state_1_1;	// @[generators/rocket-chip/src/main/scala/tilelink/Arbiter.scala:61:28, :88:26, :89:25, generators/rocket-chip/src/main/scala/tilelink/Broadcast.scala:113:15]
  wire        muxState_1_2 = idle_1 ? winner_1_2 : state_1_2;	// @[generators/rocket-chip/src/main/scala/tilelink/Arbiter.scala:61:28, :71:69, :88:26, :89:25]
  wire        muxState_1_3 = idle_1 ? winner_1_3 : state_1_3;	// @[generators/rocket-chip/src/main/scala/tilelink/Arbiter.scala:61:28, :71:69, :88:26, :89:25]
  wire        muxState_1_4 = idle_1 ? winner_1_4 : state_1_4;	// @[generators/rocket-chip/src/main/scala/tilelink/Arbiter.scala:61:28, :71:69, :88:26, :89:25]
  wire        nodeOut_a_valid = idle_1 ? _TLBroadcastTracker_io_out_a_valid | _TLBroadcastTracker_1_io_out_a_valid | _TLBroadcastTracker_2_io_out_a_valid | _TLBroadcastTracker_3_io_out_a_valid : state_1_1 & _TLBroadcastTracker_io_out_a_valid | state_1_2 & _TLBroadcastTracker_1_io_out_a_valid | state_1_3 & _TLBroadcastTracker_2_io_out_a_valid | state_1_4 & _TLBroadcastTracker_3_io_out_a_valid;	// @[generators/rocket-chip/src/main/scala/tilelink/Arbiter.scala:61:28, :88:26, :96:{24,46}, generators/rocket-chip/src/main/scala/tilelink/Broadcast.scala:113:15, src/main/scala/chisel3/util/Mux.scala:30:73]
  reg  [2:0]  a_first_counter;	// @[generators/rocket-chip/src/main/scala/tilelink/Edges.scala:229:27]
  wire        a_first = a_first_counter == 3'h0;	// @[generators/rocket-chip/src/main/scala/tilelink/Edges.scala:229:27, :231:25]
  wire        _matchTrackers_T_1 = _TLBroadcastTracker_io_line == auto_in_a_bits_address[31:6];	// @[generators/rocket-chip/src/main/scala/tilelink/Broadcast.scala:113:15, :242:{62,84}]
  wire        _matchTrackers_T_3 = _TLBroadcastTracker_1_io_line == auto_in_a_bits_address[31:6];	// @[generators/rocket-chip/src/main/scala/tilelink/Broadcast.scala:113:15, :242:{62,84}]
  wire        _matchTrackers_T_5 = _TLBroadcastTracker_2_io_line == auto_in_a_bits_address[31:6];	// @[generators/rocket-chip/src/main/scala/tilelink/Broadcast.scala:113:15, :242:{62,84}]
  wire        _matchTrackers_T_7 = _TLBroadcastTracker_3_io_line == auto_in_a_bits_address[31:6];	// @[generators/rocket-chip/src/main/scala/tilelink/Broadcast.scala:113:15, :242:{62,84}]
  wire [3:0]  _GEN_4 = (|{_matchTrackers_T_7, _matchTrackers_T_5, _matchTrackers_T_3, _matchTrackers_T_1}) ? {_matchTrackers_T_7, _matchTrackers_T_5, _matchTrackers_T_3, _matchTrackers_T_1} : {~(_TLBroadcastTracker_2_io_idle | _TLBroadcastTracker_1_io_idle | _TLBroadcastTracker_io_idle), ~(_TLBroadcastTracker_1_io_idle | _TLBroadcastTracker_io_idle), ~_TLBroadcastTracker_io_idle, 1'h1} & {_TLBroadcastTracker_3_io_idle, _TLBroadcastTracker_2_io_idle, _TLBroadcastTracker_1_io_idle, _TLBroadcastTracker_io_idle};	// @[generators/rocket-chip/src/main/scala/tilelink/Broadcast.scala:113:15, :240:64, :242:{62,100}, :243:40, :244:{39,41}, :245:30, generators/rocket-chip/src/main/scala/util/package.scala:253:43]
  wire [3:0]  _GEN_5 = _GEN_4 & {_TLBroadcastTracker_3_io_in_a_ready, _TLBroadcastTracker_2_io_in_a_ready, _TLBroadcastTracker_1_io_in_a_ready, _TLBroadcastTracker_io_in_a_ready};	// @[generators/rocket-chip/src/main/scala/tilelink/Broadcast.scala:113:15, :245:30, :246:63, :247:41]
  wire [12:0] _decode_T_5 = 13'h3F << _GEN_0;	// @[generators/rocket-chip/src/main/scala/util/package.scala:243:71]
  wire [12:0] _decode_T_25 = 13'h3F << _TLBroadcastTracker_3_io_out_a_bits_size;	// @[generators/rocket-chip/src/main/scala/tilelink/Broadcast.scala:113:15, generators/rocket-chip/src/main/scala/util/package.scala:243:71]
  wire [12:0] _decode_T_21 = 13'h3F << _TLBroadcastTracker_2_io_out_a_bits_size;	// @[generators/rocket-chip/src/main/scala/tilelink/Broadcast.scala:113:15, generators/rocket-chip/src/main/scala/util/package.scala:243:71]
  wire [12:0] _decode_T_17 = 13'h3F << _TLBroadcastTracker_1_io_out_a_bits_size;	// @[generators/rocket-chip/src/main/scala/tilelink/Broadcast.scala:113:15, generators/rocket-chip/src/main/scala/util/package.scala:243:71]
  wire [12:0] _decode_T_13 = 13'h3F << _TLBroadcastTracker_io_out_a_bits_size;	// @[generators/rocket-chip/src/main/scala/tilelink/Broadcast.scala:113:15, generators/rocket-chip/src/main/scala/util/package.scala:243:71]
  wire [12:0] _a_first_beats1_decode_T_1 = 13'h3F << auto_in_a_bits_size;	// @[generators/rocket-chip/src/main/scala/util/package.scala:243:71]
  always @(posedge clock) begin
    if (reset) begin
      counter <= 3'h0;	// @[generators/rocket-chip/src/main/scala/tilelink/Edges.scala:229:27]
      beatsLeft <= 3'h0;	// @[generators/rocket-chip/src/main/scala/tilelink/Arbiter.scala:60:30]
      state_1 <= 1'h0;	// @[generators/rocket-chip/src/main/scala/tilelink/Arbiter.scala:88:26]
      beatsLeft_1 <= 3'h0;	// @[generators/rocket-chip/src/main/scala/tilelink/Arbiter.scala:60:30]
      state_1_1 <= 1'h0;	// @[generators/rocket-chip/src/main/scala/tilelink/Arbiter.scala:88:26]
      state_1_2 <= 1'h0;	// @[generators/rocket-chip/src/main/scala/tilelink/Arbiter.scala:88:26]
      state_1_3 <= 1'h0;	// @[generators/rocket-chip/src/main/scala/tilelink/Arbiter.scala:88:26]
      state_1_4 <= 1'h0;	// @[generators/rocket-chip/src/main/scala/tilelink/Arbiter.scala:88:26]
      a_first_counter <= 3'h0;	// @[generators/rocket-chip/src/main/scala/tilelink/Edges.scala:229:27]
    end
    else begin
      if (_GEN) begin	// @[src/main/scala/chisel3/util/Decoupled.scala:52:35]
        if (d_first)	// @[generators/rocket-chip/src/main/scala/tilelink/Edges.scala:231:25]
          counter <= beats1;	// @[generators/rocket-chip/src/main/scala/tilelink/Edges.scala:221:14, :229:27]
        else	// @[generators/rocket-chip/src/main/scala/tilelink/Edges.scala:231:25]
          counter <= counter - 3'h1;	// @[generators/rocket-chip/src/main/scala/tilelink/Edges.scala:229:27, :230:28]
      end
      if (idle & auto_in_d_ready)	// @[generators/rocket-chip/src/main/scala/tilelink/Arbiter.scala:61:28, :62:24]
        beatsLeft <= winner_1 & d_normal_bits_opcode[0] ? ~(_decode_T_5[5:3]) : 3'h0;	// @[generators/rocket-chip/src/main/scala/tilelink/Arbiter.scala:60:30, :82:69, generators/rocket-chip/src/main/scala/tilelink/Broadcast.scala:135:48, :136:21, :137:24, :138:30, generators/rocket-chip/src/main/scala/tilelink/Edges.scala:106:36, :221:14, generators/rocket-chip/src/main/scala/util/package.scala:243:{46,71,76}]
      else	// @[generators/rocket-chip/src/main/scala/tilelink/Arbiter.scala:62:24]
        beatsLeft <= beatsLeft - {2'h0, auto_in_d_ready & nodeIn_d_valid};	// @[generators/rocket-chip/src/main/scala/tilelink/Arbiter.scala:60:30, :85:52, :96:24, src/main/scala/chisel3/util/Decoupled.scala:52:35]
      if (idle)	// @[generators/rocket-chip/src/main/scala/tilelink/Arbiter.scala:61:28]
        state_1 <= winner_1;	// @[generators/rocket-chip/src/main/scala/tilelink/Arbiter.scala:88:26, generators/rocket-chip/src/main/scala/tilelink/Broadcast.scala:135:48]
      if (idle_1 & auto_out_a_ready)	// @[generators/rocket-chip/src/main/scala/tilelink/Arbiter.scala:61:28, :62:24]
        beatsLeft_1 <= (_TLBroadcastTracker_io_out_a_valid & ~(_TLBroadcastTracker_io_out_a_bits_opcode[2]) ? ~(_decode_T_13[5:3]) : 3'h0) | (winner_1_2 & ~(_TLBroadcastTracker_1_io_out_a_bits_opcode[2]) ? ~(_decode_T_17[5:3]) : 3'h0) | (winner_1_3 & ~(_TLBroadcastTracker_2_io_out_a_bits_opcode[2]) ? ~(_decode_T_21[5:3]) : 3'h0) | (winner_1_4 & ~(_TLBroadcastTracker_3_io_out_a_bits_opcode[2]) ? ~(_decode_T_25[5:3]) : 3'h0);	// @[generators/rocket-chip/src/main/scala/tilelink/Arbiter.scala:60:30, :71:69, :82:69, :84:44, generators/rocket-chip/src/main/scala/tilelink/Broadcast.scala:113:15, generators/rocket-chip/src/main/scala/tilelink/Edges.scala:92:{28,37}, :221:14, generators/rocket-chip/src/main/scala/util/package.scala:243:{46,71,76}]
      else	// @[generators/rocket-chip/src/main/scala/tilelink/Arbiter.scala:62:24]
        beatsLeft_1 <= beatsLeft_1 - {2'h0, auto_out_a_ready & nodeOut_a_valid};	// @[generators/rocket-chip/src/main/scala/tilelink/Arbiter.scala:60:30, :85:52, :96:24, src/main/scala/chisel3/util/Decoupled.scala:52:35]
      if (idle_1) begin	// @[generators/rocket-chip/src/main/scala/tilelink/Arbiter.scala:61:28]
        state_1_1 <= _TLBroadcastTracker_io_out_a_valid;	// @[generators/rocket-chip/src/main/scala/tilelink/Arbiter.scala:88:26, generators/rocket-chip/src/main/scala/tilelink/Broadcast.scala:113:15]
        state_1_2 <= winner_1_2;	// @[generators/rocket-chip/src/main/scala/tilelink/Arbiter.scala:71:69, :88:26]
        state_1_3 <= winner_1_3;	// @[generators/rocket-chip/src/main/scala/tilelink/Arbiter.scala:71:69, :88:26]
        state_1_4 <= winner_1_4;	// @[generators/rocket-chip/src/main/scala/tilelink/Arbiter.scala:71:69, :88:26]
      end
      if ((|_GEN_5) & auto_in_a_valid) begin	// @[generators/rocket-chip/src/main/scala/tilelink/Broadcast.scala:247:{41,58}, src/main/scala/chisel3/util/Decoupled.scala:52:35]
        if (a_first)	// @[generators/rocket-chip/src/main/scala/tilelink/Edges.scala:231:25]
          a_first_counter <= auto_in_a_bits_opcode[2] ? 3'h0 : ~(_a_first_beats1_decode_T_1[5:3]);	// @[generators/rocket-chip/src/main/scala/tilelink/Edges.scala:92:37, :221:14, :229:27, generators/rocket-chip/src/main/scala/util/package.scala:243:{46,71,76}]
        else	// @[generators/rocket-chip/src/main/scala/tilelink/Edges.scala:231:25]
          a_first_counter <= a_first_counter - 3'h1;	// @[generators/rocket-chip/src/main/scala/tilelink/Edges.scala:229:27, :230:28]
      end
    end
    if (d_first)	// @[generators/rocket-chip/src/main/scala/tilelink/Edges.scala:231:25]
      d_trackerOH_r <= _d_trackerOH_T_8;	// @[generators/rocket-chip/src/main/scala/tilelink/Broadcast.scala:129:102, generators/rocket-chip/src/main/scala/util/package.scala:88:63]
  end // always @(posedge)
  `ifdef ENABLE_INITIAL_REG_
    `ifdef FIRRTL_BEFORE_INITIAL
      `FIRRTL_BEFORE_INITIAL
    `endif // FIRRTL_BEFORE_INITIAL
    logic [31:0] _RANDOM[0:1];
    initial begin
      `ifdef INIT_RANDOM_PROLOG_
        `INIT_RANDOM_PROLOG_
      `endif // INIT_RANDOM_PROLOG_
      `ifdef RANDOMIZE_REG_INIT
        for (logic [1:0] i = 2'h0; i < 2'h2; i += 2'h1) begin
          _RANDOM[i[0]] = `RANDOM;
        end
        counter = _RANDOM[1'h0][2:0];	// @[generators/rocket-chip/src/main/scala/tilelink/Edges.scala:229:27]
        d_trackerOH_r = _RANDOM[1'h0][6:3];	// @[generators/rocket-chip/src/main/scala/tilelink/Edges.scala:229:27, generators/rocket-chip/src/main/scala/util/package.scala:88:63]
        beatsLeft = _RANDOM[1'h0][12:10];	// @[generators/rocket-chip/src/main/scala/tilelink/Arbiter.scala:60:30, generators/rocket-chip/src/main/scala/tilelink/Edges.scala:229:27]
        state_1 = _RANDOM[1'h0][14];	// @[generators/rocket-chip/src/main/scala/tilelink/Arbiter.scala:88:26, generators/rocket-chip/src/main/scala/tilelink/Edges.scala:229:27]
        beatsLeft_1 = _RANDOM[1'h0][17:15];	// @[generators/rocket-chip/src/main/scala/tilelink/Arbiter.scala:60:30, generators/rocket-chip/src/main/scala/tilelink/Edges.scala:229:27]
        state_1_1 = _RANDOM[1'h0][19];	// @[generators/rocket-chip/src/main/scala/tilelink/Arbiter.scala:88:26, generators/rocket-chip/src/main/scala/tilelink/Edges.scala:229:27]
        state_1_2 = _RANDOM[1'h0][20];	// @[generators/rocket-chip/src/main/scala/tilelink/Arbiter.scala:88:26, generators/rocket-chip/src/main/scala/tilelink/Edges.scala:229:27]
        state_1_3 = _RANDOM[1'h0][21];	// @[generators/rocket-chip/src/main/scala/tilelink/Arbiter.scala:88:26, generators/rocket-chip/src/main/scala/tilelink/Edges.scala:229:27]
        state_1_4 = _RANDOM[1'h0][22];	// @[generators/rocket-chip/src/main/scala/tilelink/Arbiter.scala:88:26, generators/rocket-chip/src/main/scala/tilelink/Edges.scala:229:27]
        a_first_counter = _RANDOM[1'h1][22:20];	// @[generators/rocket-chip/src/main/scala/tilelink/Edges.scala:229:27]
      `endif // RANDOMIZE_REG_INIT
    end // initial
    `ifdef FIRRTL_AFTER_INITIAL
      `FIRRTL_AFTER_INITIAL
    `endif // FIRRTL_AFTER_INITIAL
  `endif // ENABLE_INITIAL_REG_
  TLBroadcastTracker TLBroadcastTracker (	// @[generators/rocket-chip/src/main/scala/tilelink/Broadcast.scala:113:15]
    .clock                 (clock),
    .reset                 (reset),
    .io_in_a_first         (a_first),	// @[generators/rocket-chip/src/main/scala/tilelink/Edges.scala:231:25]
    .io_in_a_ready         (_TLBroadcastTracker_io_in_a_ready),
    .io_in_a_valid         (auto_in_a_valid & _GEN_4[0]),	// @[generators/rocket-chip/src/main/scala/tilelink/Broadcast.scala:245:30, :250:35, :251:36]
    .io_in_a_bits_opcode   (auto_in_a_bits_opcode),
    .io_in_a_bits_param    (auto_in_a_bits_param),
    .io_in_a_bits_size     (auto_in_a_bits_size),
    .io_in_a_bits_source   (auto_in_a_bits_source),
    .io_in_a_bits_address  (auto_in_a_bits_address),
    .io_in_a_bits_mask     (auto_in_a_bits_mask),
    .io_in_a_bits_data     (auto_in_a_bits_data),
    .io_out_a_ready        (auto_out_a_ready & (idle_1 | state_1_1)),	// @[generators/rocket-chip/src/main/scala/tilelink/Arbiter.scala:61:28, :88:26, :92:24, :94:31]
    .io_out_a_valid        (_TLBroadcastTracker_io_out_a_valid),
    .io_out_a_bits_opcode  (_TLBroadcastTracker_io_out_a_bits_opcode),
    .io_out_a_bits_param   (_TLBroadcastTracker_io_out_a_bits_param),
    .io_out_a_bits_size    (_TLBroadcastTracker_io_out_a_bits_size),
    .io_out_a_bits_source  (_TLBroadcastTracker_io_out_a_bits_source),
    .io_out_a_bits_address (_TLBroadcastTracker_io_out_a_bits_address),
    .io_out_a_bits_mask    (_TLBroadcastTracker_io_out_a_bits_mask),
    .io_out_a_bits_data    (_TLBroadcastTracker_io_out_a_bits_data),
    .io_probedack          (d_trackerOH[0] & _GEN_1 & d_drop),	// @[generators/rocket-chip/src/main/scala/tilelink/Broadcast.scala:125:27, :147:33, :149:{37,51}, generators/rocket-chip/src/main/scala/util/package.scala:88:42, src/main/scala/chisel3/util/Decoupled.scala:52:35]
    .io_d_last             (d_trackerOH[0] & _GEN & d_response & d_last),	// @[generators/rocket-chip/src/main/scala/tilelink/Broadcast.scala:146:34, :147:33, :148:{34,51,65}, generators/rocket-chip/src/main/scala/tilelink/Edges.scala:232:33, generators/rocket-chip/src/main/scala/util/package.scala:88:42, src/main/scala/chisel3/util/Decoupled.scala:52:35]
    .io_source             (_TLBroadcastTracker_io_source),
    .io_line               (_TLBroadcastTracker_io_line),
    .io_idle               (_TLBroadcastTracker_io_idle),
    .io_need_d             (_TLBroadcastTracker_io_need_d)
  );	// @[generators/rocket-chip/src/main/scala/tilelink/Broadcast.scala:113:15]
  TLBroadcastTracker_1 TLBroadcastTracker_1 (	// @[generators/rocket-chip/src/main/scala/tilelink/Broadcast.scala:113:15]
    .clock                 (clock),
    .reset                 (reset),
    .io_in_a_first         (a_first),	// @[generators/rocket-chip/src/main/scala/tilelink/Edges.scala:231:25]
    .io_in_a_ready         (_TLBroadcastTracker_1_io_in_a_ready),
    .io_in_a_valid         (auto_in_a_valid & _GEN_4[1]),	// @[generators/rocket-chip/src/main/scala/tilelink/Broadcast.scala:245:30, :250:35, :251:36]
    .io_in_a_bits_opcode   (auto_in_a_bits_opcode),
    .io_in_a_bits_param    (auto_in_a_bits_param),
    .io_in_a_bits_size     (auto_in_a_bits_size),
    .io_in_a_bits_source   (auto_in_a_bits_source),
    .io_in_a_bits_address  (auto_in_a_bits_address),
    .io_in_a_bits_mask     (auto_in_a_bits_mask),
    .io_in_a_bits_data     (auto_in_a_bits_data),
    .io_out_a_ready        (auto_out_a_ready & (idle_1 ? ~_TLBroadcastTracker_io_out_a_valid : state_1_2)),	// @[generators/rocket-chip/src/main/scala/tilelink/Arbiter.scala:16:61, :61:28, :88:26, :92:24, :94:31, generators/rocket-chip/src/main/scala/tilelink/Broadcast.scala:113:15]
    .io_out_a_valid        (_TLBroadcastTracker_1_io_out_a_valid),
    .io_out_a_bits_opcode  (_TLBroadcastTracker_1_io_out_a_bits_opcode),
    .io_out_a_bits_param   (_TLBroadcastTracker_1_io_out_a_bits_param),
    .io_out_a_bits_size    (_TLBroadcastTracker_1_io_out_a_bits_size),
    .io_out_a_bits_source  (_TLBroadcastTracker_1_io_out_a_bits_source),
    .io_out_a_bits_address (_TLBroadcastTracker_1_io_out_a_bits_address),
    .io_out_a_bits_mask    (_TLBroadcastTracker_1_io_out_a_bits_mask),
    .io_out_a_bits_data    (_TLBroadcastTracker_1_io_out_a_bits_data),
    .io_probedack          (d_trackerOH[1] & _GEN_1 & d_drop),	// @[generators/rocket-chip/src/main/scala/tilelink/Broadcast.scala:125:27, :147:33, :149:{37,51}, generators/rocket-chip/src/main/scala/util/package.scala:88:42, src/main/scala/chisel3/util/Decoupled.scala:52:35]
    .io_d_last             (d_trackerOH[1] & _GEN & d_response & d_last),	// @[generators/rocket-chip/src/main/scala/tilelink/Broadcast.scala:146:34, :147:33, :148:{34,51,65}, generators/rocket-chip/src/main/scala/tilelink/Edges.scala:232:33, generators/rocket-chip/src/main/scala/util/package.scala:88:42, src/main/scala/chisel3/util/Decoupled.scala:52:35]
    .io_source             (_TLBroadcastTracker_1_io_source),
    .io_line               (_TLBroadcastTracker_1_io_line),
    .io_idle               (_TLBroadcastTracker_1_io_idle),
    .io_need_d             (_TLBroadcastTracker_1_io_need_d)
  );	// @[generators/rocket-chip/src/main/scala/tilelink/Broadcast.scala:113:15]
  TLBroadcastTracker_2 TLBroadcastTracker_2 (	// @[generators/rocket-chip/src/main/scala/tilelink/Broadcast.scala:113:15]
    .clock                 (clock),
    .reset                 (reset),
    .io_in_a_first         (a_first),	// @[generators/rocket-chip/src/main/scala/tilelink/Edges.scala:231:25]
    .io_in_a_ready         (_TLBroadcastTracker_2_io_in_a_ready),
    .io_in_a_valid         (auto_in_a_valid & _GEN_4[2]),	// @[generators/rocket-chip/src/main/scala/tilelink/Broadcast.scala:245:30, :250:35, :251:36]
    .io_in_a_bits_opcode   (auto_in_a_bits_opcode),
    .io_in_a_bits_param    (auto_in_a_bits_param),
    .io_in_a_bits_size     (auto_in_a_bits_size),
    .io_in_a_bits_source   (auto_in_a_bits_source),
    .io_in_a_bits_address  (auto_in_a_bits_address),
    .io_in_a_bits_mask     (auto_in_a_bits_mask),
    .io_in_a_bits_data     (auto_in_a_bits_data),
    .io_out_a_ready        (auto_out_a_ready & (idle_1 ? ~_GEN_2 : state_1_3)),	// @[generators/rocket-chip/src/main/scala/tilelink/Arbiter.scala:16:61, :61:28, :88:26, :92:24, :94:31, generators/rocket-chip/src/main/scala/util/package.scala:253:43]
    .io_out_a_valid        (_TLBroadcastTracker_2_io_out_a_valid),
    .io_out_a_bits_opcode  (_TLBroadcastTracker_2_io_out_a_bits_opcode),
    .io_out_a_bits_param   (_TLBroadcastTracker_2_io_out_a_bits_param),
    .io_out_a_bits_size    (_TLBroadcastTracker_2_io_out_a_bits_size),
    .io_out_a_bits_source  (_TLBroadcastTracker_2_io_out_a_bits_source),
    .io_out_a_bits_address (_TLBroadcastTracker_2_io_out_a_bits_address),
    .io_out_a_bits_mask    (_TLBroadcastTracker_2_io_out_a_bits_mask),
    .io_out_a_bits_data    (_TLBroadcastTracker_2_io_out_a_bits_data),
    .io_probedack          (d_trackerOH[2] & _GEN_1 & d_drop),	// @[generators/rocket-chip/src/main/scala/tilelink/Broadcast.scala:125:27, :147:33, :149:{37,51}, generators/rocket-chip/src/main/scala/util/package.scala:88:42, src/main/scala/chisel3/util/Decoupled.scala:52:35]
    .io_d_last             (d_trackerOH[2] & _GEN & d_response & d_last),	// @[generators/rocket-chip/src/main/scala/tilelink/Broadcast.scala:146:34, :147:33, :148:{34,51,65}, generators/rocket-chip/src/main/scala/tilelink/Edges.scala:232:33, generators/rocket-chip/src/main/scala/util/package.scala:88:42, src/main/scala/chisel3/util/Decoupled.scala:52:35]
    .io_source             (_TLBroadcastTracker_2_io_source),
    .io_line               (_TLBroadcastTracker_2_io_line),
    .io_idle               (_TLBroadcastTracker_2_io_idle),
    .io_need_d             (_TLBroadcastTracker_2_io_need_d)
  );	// @[generators/rocket-chip/src/main/scala/tilelink/Broadcast.scala:113:15]
  TLBroadcastTracker_3 TLBroadcastTracker_3 (	// @[generators/rocket-chip/src/main/scala/tilelink/Broadcast.scala:113:15]
    .clock                 (clock),
    .reset                 (reset),
    .io_in_a_first         (a_first),	// @[generators/rocket-chip/src/main/scala/tilelink/Edges.scala:231:25]
    .io_in_a_ready         (_TLBroadcastTracker_3_io_in_a_ready),
    .io_in_a_valid         (auto_in_a_valid & _GEN_4[3]),	// @[generators/rocket-chip/src/main/scala/tilelink/Broadcast.scala:245:30, :250:35, :251:36]
    .io_in_a_bits_opcode   (auto_in_a_bits_opcode),
    .io_in_a_bits_param    (auto_in_a_bits_param),
    .io_in_a_bits_size     (auto_in_a_bits_size),
    .io_in_a_bits_source   (auto_in_a_bits_source),
    .io_in_a_bits_address  (auto_in_a_bits_address),
    .io_in_a_bits_mask     (auto_in_a_bits_mask),
    .io_in_a_bits_data     (auto_in_a_bits_data),
    .io_out_a_ready        (auto_out_a_ready & (idle_1 ? ~_GEN_3 : state_1_4)),	// @[generators/rocket-chip/src/main/scala/tilelink/Arbiter.scala:16:61, :61:28, :88:26, :92:24, :94:31, generators/rocket-chip/src/main/scala/util/package.scala:253:43]
    .io_out_a_valid        (_TLBroadcastTracker_3_io_out_a_valid),
    .io_out_a_bits_opcode  (_TLBroadcastTracker_3_io_out_a_bits_opcode),
    .io_out_a_bits_param   (_TLBroadcastTracker_3_io_out_a_bits_param),
    .io_out_a_bits_size    (_TLBroadcastTracker_3_io_out_a_bits_size),
    .io_out_a_bits_source  (_TLBroadcastTracker_3_io_out_a_bits_source),
    .io_out_a_bits_address (_TLBroadcastTracker_3_io_out_a_bits_address),
    .io_out_a_bits_mask    (_TLBroadcastTracker_3_io_out_a_bits_mask),
    .io_out_a_bits_data    (_TLBroadcastTracker_3_io_out_a_bits_data),
    .io_probedack          (d_trackerOH[3] & _GEN_1 & d_drop),	// @[generators/rocket-chip/src/main/scala/tilelink/Broadcast.scala:125:27, :147:33, :149:{37,51}, generators/rocket-chip/src/main/scala/util/package.scala:88:42, src/main/scala/chisel3/util/Decoupled.scala:52:35]
    .io_d_last             (d_trackerOH[3] & _GEN & d_response & d_last),	// @[generators/rocket-chip/src/main/scala/tilelink/Broadcast.scala:146:34, :147:33, :148:{34,51,65}, generators/rocket-chip/src/main/scala/tilelink/Edges.scala:232:33, generators/rocket-chip/src/main/scala/util/package.scala:88:42, src/main/scala/chisel3/util/Decoupled.scala:52:35]
    .io_source             (_TLBroadcastTracker_3_io_source),
    .io_line               (_TLBroadcastTracker_3_io_line),
    .io_idle               (_TLBroadcastTracker_3_io_idle),
    .io_need_d             (_TLBroadcastTracker_3_io_need_d)
  );	// @[generators/rocket-chip/src/main/scala/tilelink/Broadcast.scala:113:15]
  assign auto_in_a_ready = |_GEN_5;	// @[generators/rocket-chip/src/main/scala/tilelink/Broadcast.scala:247:{41,58}]
  assign auto_in_d_valid = nodeIn_d_valid;	// @[generators/rocket-chip/src/main/scala/tilelink/Arbiter.scala:96:24]
  assign auto_in_d_bits_opcode = muxState_1 ? d_normal_bits_opcode : 3'h0;	// @[generators/rocket-chip/src/main/scala/tilelink/Arbiter.scala:89:25, generators/rocket-chip/src/main/scala/tilelink/Broadcast.scala:136:21, :137:24, :138:30, src/main/scala/chisel3/util/Mux.scala:30:73]
  assign auto_in_d_bits_param = muxState_1 ? (auto_out_d_bits_source[10] ? (auto_out_d_bits_opcode[0] ? {1'h0, ~(auto_out_d_bits_source[9])} : 2'h0) : auto_out_d_bits_param) : 2'h0;	// @[generators/rocket-chip/src/main/scala/tilelink/Arbiter.scala:89:25, generators/rocket-chip/src/main/scala/tilelink/Broadcast.scala:124:37, :136:21, :137:{19,24}, :139:{30,36,51,58}, generators/rocket-chip/src/main/scala/tilelink/Edges.scala:106:36, src/main/scala/chisel3/util/Mux.scala:30:73]
  assign auto_in_d_bits_size = muxState_1 ? auto_out_d_bits_size : 3'h0;	// @[generators/rocket-chip/src/main/scala/tilelink/Arbiter.scala:89:25, src/main/scala/chisel3/util/Mux.scala:30:73]
  assign auto_in_d_bits_source = muxState_1 ? d_normal_bits_source : 9'h0;	// @[generators/rocket-chip/src/main/scala/tilelink/Arbiter.scala:89:25, generators/rocket-chip/src/main/scala/tilelink/Broadcast.scala:136:21, src/main/scala/chisel3/util/Mux.scala:30:73]
  assign auto_in_d_bits_sink = muxState_1 ? {|(d_trackerOH[3:2]), d_trackerOH[3] | d_trackerOH[1]} : 2'h0;	// @[generators/rocket-chip/src/main/scala/tilelink/Arbiter.scala:89:25, generators/rocket-chip/src/main/scala/util/package.scala:88:42, src/main/scala/chisel3/util/Mux.scala:30:73, src/main/scala/chisel3/util/OneHot.scala:30:18, :31:18, :32:{10,14,28}]
  assign auto_in_d_bits_denied = muxState_1 & auto_out_d_bits_denied;	// @[generators/rocket-chip/src/main/scala/tilelink/Arbiter.scala:89:25, src/main/scala/chisel3/util/Mux.scala:30:73]
  assign auto_in_d_bits_data = muxState_1 ? auto_out_d_bits_data : 64'h0;	// @[generators/rocket-chip/src/main/scala/tilelink/Arbiter.scala:89:25, src/main/scala/chisel3/util/Mux.scala:30:73]
  assign auto_in_d_bits_corrupt = muxState_1 & auto_out_d_bits_corrupt;	// @[generators/rocket-chip/src/main/scala/tilelink/Arbiter.scala:89:25, src/main/scala/chisel3/util/Mux.scala:30:73]
  assign auto_out_a_valid = nodeOut_a_valid;	// @[generators/rocket-chip/src/main/scala/tilelink/Arbiter.scala:96:24]
  assign auto_out_a_bits_opcode = (muxState_1_1 ? _TLBroadcastTracker_io_out_a_bits_opcode : 3'h0) | (muxState_1_2 ? _TLBroadcastTracker_1_io_out_a_bits_opcode : 3'h0) | (muxState_1_3 ? _TLBroadcastTracker_2_io_out_a_bits_opcode : 3'h0) | (muxState_1_4 ? _TLBroadcastTracker_3_io_out_a_bits_opcode : 3'h0);	// @[generators/rocket-chip/src/main/scala/tilelink/Arbiter.scala:89:25, generators/rocket-chip/src/main/scala/tilelink/Broadcast.scala:113:15, src/main/scala/chisel3/util/Mux.scala:30:73]
  assign auto_out_a_bits_param = (muxState_1_1 ? _TLBroadcastTracker_io_out_a_bits_param : 3'h0) | (muxState_1_2 ? _TLBroadcastTracker_1_io_out_a_bits_param : 3'h0) | (muxState_1_3 ? _TLBroadcastTracker_2_io_out_a_bits_param : 3'h0) | (muxState_1_4 ? _TLBroadcastTracker_3_io_out_a_bits_param : 3'h0);	// @[generators/rocket-chip/src/main/scala/tilelink/Arbiter.scala:89:25, generators/rocket-chip/src/main/scala/tilelink/Broadcast.scala:113:15, src/main/scala/chisel3/util/Mux.scala:30:73]
  assign auto_out_a_bits_size = (muxState_1_1 ? _TLBroadcastTracker_io_out_a_bits_size : 3'h0) | (muxState_1_2 ? _TLBroadcastTracker_1_io_out_a_bits_size : 3'h0) | (muxState_1_3 ? _TLBroadcastTracker_2_io_out_a_bits_size : 3'h0) | (muxState_1_4 ? _TLBroadcastTracker_3_io_out_a_bits_size : 3'h0);	// @[generators/rocket-chip/src/main/scala/tilelink/Arbiter.scala:89:25, generators/rocket-chip/src/main/scala/tilelink/Broadcast.scala:113:15, src/main/scala/chisel3/util/Mux.scala:30:73]
  assign auto_out_a_bits_source = (muxState_1_1 ? _TLBroadcastTracker_io_out_a_bits_source : 11'h0) | (muxState_1_2 ? _TLBroadcastTracker_1_io_out_a_bits_source : 11'h0) | (muxState_1_3 ? _TLBroadcastTracker_2_io_out_a_bits_source : 11'h0) | (muxState_1_4 ? _TLBroadcastTracker_3_io_out_a_bits_source : 11'h0);	// @[generators/rocket-chip/src/main/scala/tilelink/Arbiter.scala:89:25, generators/rocket-chip/src/main/scala/tilelink/Broadcast.scala:113:15, src/main/scala/chisel3/util/Mux.scala:30:73]
  assign auto_out_a_bits_address = (muxState_1_1 ? _TLBroadcastTracker_io_out_a_bits_address : 32'h0) | (muxState_1_2 ? _TLBroadcastTracker_1_io_out_a_bits_address : 32'h0) | (muxState_1_3 ? _TLBroadcastTracker_2_io_out_a_bits_address : 32'h0) | (muxState_1_4 ? _TLBroadcastTracker_3_io_out_a_bits_address : 32'h0);	// @[generators/rocket-chip/src/main/scala/tilelink/Arbiter.scala:89:25, generators/rocket-chip/src/main/scala/tilelink/Broadcast.scala:113:15, src/main/scala/chisel3/util/Mux.scala:30:73]
  assign auto_out_a_bits_mask = (muxState_1_1 ? _TLBroadcastTracker_io_out_a_bits_mask : 8'h0) | (muxState_1_2 ? _TLBroadcastTracker_1_io_out_a_bits_mask : 8'h0) | (muxState_1_3 ? _TLBroadcastTracker_2_io_out_a_bits_mask : 8'h0) | (muxState_1_4 ? _TLBroadcastTracker_3_io_out_a_bits_mask : 8'h0);	// @[generators/rocket-chip/src/main/scala/tilelink/Arbiter.scala:89:25, generators/rocket-chip/src/main/scala/tilelink/Broadcast.scala:113:15, src/main/scala/chisel3/util/Mux.scala:30:73]
  assign auto_out_a_bits_data = (muxState_1_1 ? _TLBroadcastTracker_io_out_a_bits_data : 64'h0) | (muxState_1_2 ? _TLBroadcastTracker_1_io_out_a_bits_data : 64'h0) | (muxState_1_3 ? _TLBroadcastTracker_2_io_out_a_bits_data : 64'h0) | (muxState_1_4 ? _TLBroadcastTracker_3_io_out_a_bits_data : 64'h0);	// @[generators/rocket-chip/src/main/scala/tilelink/Arbiter.scala:89:25, generators/rocket-chip/src/main/scala/tilelink/Broadcast.scala:113:15, src/main/scala/chisel3/util/Mux.scala:30:73]
  assign auto_out_d_ready = nodeOut_d_ready;	// @[generators/rocket-chip/src/main/scala/tilelink/Broadcast.scala:134:50]
endmodule

