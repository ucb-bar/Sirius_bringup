// Generated by CIRCT firtool-1.66.0
// Standard header to adapt well known macros for register randomization.
`ifndef RANDOMIZE
  `ifdef RANDOMIZE_MEM_INIT
    `define RANDOMIZE
  `endif // RANDOMIZE_MEM_INIT
`endif // not def RANDOMIZE
`ifndef RANDOMIZE
  `ifdef RANDOMIZE_REG_INIT
    `define RANDOMIZE
  `endif // RANDOMIZE_REG_INIT
`endif // not def RANDOMIZE

// RANDOM may be set to an expression that produces a 32-bit random unsigned value.
`ifndef RANDOM
  `define RANDOM $random
`endif // not def RANDOM

// Users can define INIT_RANDOM as general code that gets injected into the
// initializer block for modules with registers.
`ifndef INIT_RANDOM
  `define INIT_RANDOM
`endif // not def INIT_RANDOM

// If using random initialization, you can also define RANDOMIZE_DELAY to
// customize the delay used, otherwise 0.002 is used.
`ifndef RANDOMIZE_DELAY
  `define RANDOMIZE_DELAY 0.002
`endif // not def RANDOMIZE_DELAY

// Define INIT_RANDOM_PROLOG_ for use in our modules below.
`ifndef INIT_RANDOM_PROLOG_
  `ifdef RANDOMIZE
    `ifdef VERILATOR
      `define INIT_RANDOM_PROLOG_ `INIT_RANDOM
    `else  // VERILATOR
      `define INIT_RANDOM_PROLOG_ `INIT_RANDOM #`RANDOMIZE_DELAY begin end
    `endif // VERILATOR
  `else  // RANDOMIZE
    `define INIT_RANDOM_PROLOG_
  `endif // RANDOMIZE
`endif // not def INIT_RANDOM_PROLOG_

// Include register initializers in init blocks unless synthesis is set
`ifndef SYNTHESIS
  `ifndef ENABLE_INITIAL_REG_
    `define ENABLE_INITIAL_REG_
  `endif // not def ENABLE_INITIAL_REG_
`endif // not def SYNTHESIS

// Include rmemory initializers in init blocks unless synthesis is set
`ifndef SYNTHESIS
  `ifndef ENABLE_INITIAL_MEM_
    `define ENABLE_INITIAL_MEM_
  `endif // not def ENABLE_INITIAL_MEM_
`endif // not def SYNTHESIS

// Standard header to adapt well known macros for prints and assertions.

// Users can define 'PRINTF_COND' to add an extra gate to prints.
`ifndef PRINTF_COND_
  `ifdef PRINTF_COND
    `define PRINTF_COND_ (`PRINTF_COND)
  `else  // PRINTF_COND
    `define PRINTF_COND_ 1
  `endif // PRINTF_COND
`endif // not def PRINTF_COND_

// Users can define 'ASSERT_VERBOSE_COND' to add an extra gate to assert error printing.
`ifndef ASSERT_VERBOSE_COND_
  `ifdef ASSERT_VERBOSE_COND
    `define ASSERT_VERBOSE_COND_ (`ASSERT_VERBOSE_COND)
  `else  // ASSERT_VERBOSE_COND
    `define ASSERT_VERBOSE_COND_ 1
  `endif // ASSERT_VERBOSE_COND
`endif // not def ASSERT_VERBOSE_COND_

// Users can define 'STOP_COND' to add an extra gate to stop conditions.
`ifndef STOP_COND_
  `ifdef STOP_COND
    `define STOP_COND_ (`STOP_COND)
  `else  // STOP_COND
    `define STOP_COND_ 1
  `endif // STOP_COND
`endif // not def STOP_COND_

module PhitToFlit(
  input         clock,
  input         reset,
  output        io_in_ready,	// @[generators/testchipip/src/main/scala/serdes/Serdes.scala:99:14]
  input         io_in_valid,	// @[generators/testchipip/src/main/scala/serdes/Serdes.scala:99:14]
  input         io_in_bits_phit,	// @[generators/testchipip/src/main/scala/serdes/Serdes.scala:99:14]
  input         io_out_ready,	// @[generators/testchipip/src/main/scala/serdes/Serdes.scala:99:14]
  output        io_out_valid,	// @[generators/testchipip/src/main/scala/serdes/Serdes.scala:99:14]
  output [15:0] io_out_bits_flit	// @[generators/testchipip/src/main/scala/serdes/Serdes.scala:99:14]
);

  reg        data_0;	// @[generators/testchipip/src/main/scala/serdes/Serdes.scala:106:17]
  reg        data_1;	// @[generators/testchipip/src/main/scala/serdes/Serdes.scala:106:17]
  reg        data_2;	// @[generators/testchipip/src/main/scala/serdes/Serdes.scala:106:17]
  reg        data_3;	// @[generators/testchipip/src/main/scala/serdes/Serdes.scala:106:17]
  reg        data_4;	// @[generators/testchipip/src/main/scala/serdes/Serdes.scala:106:17]
  reg        data_5;	// @[generators/testchipip/src/main/scala/serdes/Serdes.scala:106:17]
  reg        data_6;	// @[generators/testchipip/src/main/scala/serdes/Serdes.scala:106:17]
  reg        data_7;	// @[generators/testchipip/src/main/scala/serdes/Serdes.scala:106:17]
  reg        data_8;	// @[generators/testchipip/src/main/scala/serdes/Serdes.scala:106:17]
  reg        data_9;	// @[generators/testchipip/src/main/scala/serdes/Serdes.scala:106:17]
  reg        data_10;	// @[generators/testchipip/src/main/scala/serdes/Serdes.scala:106:17]
  reg        data_11;	// @[generators/testchipip/src/main/scala/serdes/Serdes.scala:106:17]
  reg        data_12;	// @[generators/testchipip/src/main/scala/serdes/Serdes.scala:106:17]
  reg        data_13;	// @[generators/testchipip/src/main/scala/serdes/Serdes.scala:106:17]
  reg        data_14;	// @[generators/testchipip/src/main/scala/serdes/Serdes.scala:106:17]
  reg  [3:0] beat;	// @[generators/testchipip/src/main/scala/serdes/Serdes.scala:107:21]
  wire       _io_in_ready_T = beat != 4'hF;	// @[generators/testchipip/src/main/scala/serdes/Serdes.scala:107:21, :109:39]
  wire       io_in_ready_0 = io_out_ready | _io_in_ready_T;	// @[generators/testchipip/src/main/scala/serdes/Serdes.scala:109:{31,39}]
  wire       _GEN = io_in_ready_0 & io_in_valid;	// @[generators/testchipip/src/main/scala/serdes/Serdes.scala:109:31, src/main/scala/chisel3/util/Decoupled.scala:52:35]
  always @(posedge clock) begin
    if (_GEN & _io_in_ready_T & beat == 4'h0)	// @[generators/testchipip/src/main/scala/serdes/Serdes.scala:106:17, :107:21, :109:39, :113:21, :115:37, :116:18, src/main/scala/chisel3/util/Decoupled.scala:52:35]
      data_0 <= io_in_bits_phit;	// @[generators/testchipip/src/main/scala/serdes/Serdes.scala:106:17]
    if (_GEN & _io_in_ready_T & beat == 4'h1)	// @[generators/testchipip/src/main/scala/serdes/Serdes.scala:106:17, :107:21, :109:39, :113:21, :115:37, :116:18, src/main/scala/chisel3/util/Decoupled.scala:52:35]
      data_1 <= io_in_bits_phit;	// @[generators/testchipip/src/main/scala/serdes/Serdes.scala:106:17]
    if (_GEN & _io_in_ready_T & beat == 4'h2)	// @[generators/testchipip/src/main/scala/serdes/Serdes.scala:106:17, :107:21, :109:39, :113:21, :115:37, :116:18, src/main/scala/chisel3/util/Decoupled.scala:52:35]
      data_2 <= io_in_bits_phit;	// @[generators/testchipip/src/main/scala/serdes/Serdes.scala:106:17]
    if (_GEN & _io_in_ready_T & beat == 4'h3)	// @[generators/testchipip/src/main/scala/serdes/Serdes.scala:106:17, :107:21, :109:39, :113:21, :115:37, :116:18, src/main/scala/chisel3/util/Decoupled.scala:52:35]
      data_3 <= io_in_bits_phit;	// @[generators/testchipip/src/main/scala/serdes/Serdes.scala:106:17]
    if (_GEN & _io_in_ready_T & beat == 4'h4)	// @[generators/testchipip/src/main/scala/serdes/Serdes.scala:106:17, :107:21, :109:39, :113:21, :115:37, :116:18, src/main/scala/chisel3/util/Decoupled.scala:52:35]
      data_4 <= io_in_bits_phit;	// @[generators/testchipip/src/main/scala/serdes/Serdes.scala:106:17]
    if (_GEN & _io_in_ready_T & beat == 4'h5)	// @[generators/testchipip/src/main/scala/serdes/Serdes.scala:106:17, :107:21, :109:39, :113:21, :115:37, :116:18, src/main/scala/chisel3/util/Decoupled.scala:52:35]
      data_5 <= io_in_bits_phit;	// @[generators/testchipip/src/main/scala/serdes/Serdes.scala:106:17]
    if (_GEN & _io_in_ready_T & beat == 4'h6)	// @[generators/testchipip/src/main/scala/serdes/Serdes.scala:106:17, :107:21, :109:39, :113:21, :115:37, :116:18, src/main/scala/chisel3/util/Decoupled.scala:52:35]
      data_6 <= io_in_bits_phit;	// @[generators/testchipip/src/main/scala/serdes/Serdes.scala:106:17]
    if (_GEN & _io_in_ready_T & beat == 4'h7)	// @[generators/testchipip/src/main/scala/serdes/Serdes.scala:106:17, :107:21, :109:39, :113:21, :115:37, :116:18, src/main/scala/chisel3/util/Decoupled.scala:52:35]
      data_7 <= io_in_bits_phit;	// @[generators/testchipip/src/main/scala/serdes/Serdes.scala:106:17]
    if (_GEN & _io_in_ready_T & beat == 4'h8)	// @[generators/testchipip/src/main/scala/serdes/Serdes.scala:106:17, :107:21, :109:39, :113:21, :115:37, :116:18, src/main/scala/chisel3/util/Decoupled.scala:52:35]
      data_8 <= io_in_bits_phit;	// @[generators/testchipip/src/main/scala/serdes/Serdes.scala:106:17]
    if (_GEN & _io_in_ready_T & beat == 4'h9)	// @[generators/testchipip/src/main/scala/serdes/Serdes.scala:106:17, :107:21, :109:39, :113:21, :115:37, :116:18, src/main/scala/chisel3/util/Decoupled.scala:52:35]
      data_9 <= io_in_bits_phit;	// @[generators/testchipip/src/main/scala/serdes/Serdes.scala:106:17]
    if (_GEN & _io_in_ready_T & beat == 4'hA)	// @[generators/testchipip/src/main/scala/serdes/Serdes.scala:106:17, :107:21, :109:39, :113:21, :115:37, :116:18, src/main/scala/chisel3/util/Decoupled.scala:52:35]
      data_10 <= io_in_bits_phit;	// @[generators/testchipip/src/main/scala/serdes/Serdes.scala:106:17]
    if (_GEN & _io_in_ready_T & beat == 4'hB)	// @[generators/testchipip/src/main/scala/serdes/Serdes.scala:106:17, :107:21, :109:39, :113:21, :115:37, :116:18, src/main/scala/chisel3/util/Decoupled.scala:52:35]
      data_11 <= io_in_bits_phit;	// @[generators/testchipip/src/main/scala/serdes/Serdes.scala:106:17]
    if (_GEN & _io_in_ready_T & beat == 4'hC)	// @[generators/testchipip/src/main/scala/serdes/Serdes.scala:106:17, :107:21, :109:39, :113:21, :115:37, :116:18, src/main/scala/chisel3/util/Decoupled.scala:52:35]
      data_12 <= io_in_bits_phit;	// @[generators/testchipip/src/main/scala/serdes/Serdes.scala:106:17]
    if (_GEN & _io_in_ready_T & beat == 4'hD)	// @[generators/testchipip/src/main/scala/serdes/Serdes.scala:106:17, :107:21, :109:39, :113:21, :115:37, :116:18, src/main/scala/chisel3/util/Decoupled.scala:52:35]
      data_13 <= io_in_bits_phit;	// @[generators/testchipip/src/main/scala/serdes/Serdes.scala:106:17]
    if (_GEN & _io_in_ready_T & beat == 4'hE)	// @[generators/testchipip/src/main/scala/serdes/Serdes.scala:106:17, :107:21, :109:39, :113:21, :115:37, :116:18, src/main/scala/chisel3/util/Decoupled.scala:52:35]
      data_14 <= io_in_bits_phit;	// @[generators/testchipip/src/main/scala/serdes/Serdes.scala:106:17]
    if (reset)
      beat <= 4'h0;	// @[generators/testchipip/src/main/scala/serdes/Serdes.scala:107:21]
    else if (_GEN) begin	// @[src/main/scala/chisel3/util/Decoupled.scala:52:35]
      if (&beat)	// @[generators/testchipip/src/main/scala/serdes/Serdes.scala:107:21, :110:39]
        beat <= 4'h0;	// @[generators/testchipip/src/main/scala/serdes/Serdes.scala:107:21]
      else	// @[generators/testchipip/src/main/scala/serdes/Serdes.scala:110:39]
        beat <= beat + 4'h1;	// @[generators/testchipip/src/main/scala/serdes/Serdes.scala:107:21, :114:53]
    end
  end // always @(posedge)
  `ifdef ENABLE_INITIAL_REG_
    `ifdef FIRRTL_BEFORE_INITIAL
      `FIRRTL_BEFORE_INITIAL
    `endif // FIRRTL_BEFORE_INITIAL
    logic [31:0] _RANDOM[0:0];
    initial begin
      `ifdef INIT_RANDOM_PROLOG_
        `INIT_RANDOM_PROLOG_
      `endif // INIT_RANDOM_PROLOG_
      `ifdef RANDOMIZE_REG_INIT
        _RANDOM[/*Zero width*/ 1'b0] = `RANDOM;
        data_0 = _RANDOM[/*Zero width*/ 1'b0][0];	// @[generators/testchipip/src/main/scala/serdes/Serdes.scala:106:17]
        data_1 = _RANDOM[/*Zero width*/ 1'b0][1];	// @[generators/testchipip/src/main/scala/serdes/Serdes.scala:106:17]
        data_2 = _RANDOM[/*Zero width*/ 1'b0][2];	// @[generators/testchipip/src/main/scala/serdes/Serdes.scala:106:17]
        data_3 = _RANDOM[/*Zero width*/ 1'b0][3];	// @[generators/testchipip/src/main/scala/serdes/Serdes.scala:106:17]
        data_4 = _RANDOM[/*Zero width*/ 1'b0][4];	// @[generators/testchipip/src/main/scala/serdes/Serdes.scala:106:17]
        data_5 = _RANDOM[/*Zero width*/ 1'b0][5];	// @[generators/testchipip/src/main/scala/serdes/Serdes.scala:106:17]
        data_6 = _RANDOM[/*Zero width*/ 1'b0][6];	// @[generators/testchipip/src/main/scala/serdes/Serdes.scala:106:17]
        data_7 = _RANDOM[/*Zero width*/ 1'b0][7];	// @[generators/testchipip/src/main/scala/serdes/Serdes.scala:106:17]
        data_8 = _RANDOM[/*Zero width*/ 1'b0][8];	// @[generators/testchipip/src/main/scala/serdes/Serdes.scala:106:17]
        data_9 = _RANDOM[/*Zero width*/ 1'b0][9];	// @[generators/testchipip/src/main/scala/serdes/Serdes.scala:106:17]
        data_10 = _RANDOM[/*Zero width*/ 1'b0][10];	// @[generators/testchipip/src/main/scala/serdes/Serdes.scala:106:17]
        data_11 = _RANDOM[/*Zero width*/ 1'b0][11];	// @[generators/testchipip/src/main/scala/serdes/Serdes.scala:106:17]
        data_12 = _RANDOM[/*Zero width*/ 1'b0][12];	// @[generators/testchipip/src/main/scala/serdes/Serdes.scala:106:17]
        data_13 = _RANDOM[/*Zero width*/ 1'b0][13];	// @[generators/testchipip/src/main/scala/serdes/Serdes.scala:106:17]
        data_14 = _RANDOM[/*Zero width*/ 1'b0][14];	// @[generators/testchipip/src/main/scala/serdes/Serdes.scala:106:17]
        beat = _RANDOM[/*Zero width*/ 1'b0][18:15];	// @[generators/testchipip/src/main/scala/serdes/Serdes.scala:106:17, :107:21]
      `endif // RANDOMIZE_REG_INIT
    end // initial
    `ifdef FIRRTL_AFTER_INITIAL
      `FIRRTL_AFTER_INITIAL
    `endif // FIRRTL_AFTER_INITIAL
  `endif // ENABLE_INITIAL_REG_
  assign io_in_ready = io_in_ready_0;	// @[generators/testchipip/src/main/scala/serdes/Serdes.scala:109:31]
  assign io_out_valid = io_in_valid & (&beat);	// @[generators/testchipip/src/main/scala/serdes/Serdes.scala:107:21, :110:{31,39}]
  assign io_out_bits_flit = {io_in_bits_phit, data_14, data_13, data_12, data_11, data_10, data_9, data_8, data_7, data_6, data_5, data_4, data_3, data_2, data_1, data_0};	// @[generators/testchipip/src/main/scala/serdes/Serdes.scala:106:17, :111:68]
endmodule

