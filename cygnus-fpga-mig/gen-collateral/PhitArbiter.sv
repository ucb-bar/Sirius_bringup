// Generated by CIRCT firtool-1.66.0
// Standard header to adapt well known macros for register randomization.
`ifndef RANDOMIZE
  `ifdef RANDOMIZE_MEM_INIT
    `define RANDOMIZE
  `endif // RANDOMIZE_MEM_INIT
`endif // not def RANDOMIZE
`ifndef RANDOMIZE
  `ifdef RANDOMIZE_REG_INIT
    `define RANDOMIZE
  `endif // RANDOMIZE_REG_INIT
`endif // not def RANDOMIZE

// RANDOM may be set to an expression that produces a 32-bit random unsigned value.
`ifndef RANDOM
  `define RANDOM $random
`endif // not def RANDOM

// Users can define INIT_RANDOM as general code that gets injected into the
// initializer block for modules with registers.
`ifndef INIT_RANDOM
  `define INIT_RANDOM
`endif // not def INIT_RANDOM

// If using random initialization, you can also define RANDOMIZE_DELAY to
// customize the delay used, otherwise 0.002 is used.
`ifndef RANDOMIZE_DELAY
  `define RANDOMIZE_DELAY 0.002
`endif // not def RANDOMIZE_DELAY

// Define INIT_RANDOM_PROLOG_ for use in our modules below.
`ifndef INIT_RANDOM_PROLOG_
  `ifdef RANDOMIZE
    `ifdef VERILATOR
      `define INIT_RANDOM_PROLOG_ `INIT_RANDOM
    `else  // VERILATOR
      `define INIT_RANDOM_PROLOG_ `INIT_RANDOM #`RANDOMIZE_DELAY begin end
    `endif // VERILATOR
  `else  // RANDOMIZE
    `define INIT_RANDOM_PROLOG_
  `endif // RANDOMIZE
`endif // not def INIT_RANDOM_PROLOG_

// Include register initializers in init blocks unless synthesis is set
`ifndef SYNTHESIS
  `ifndef ENABLE_INITIAL_REG_
    `define ENABLE_INITIAL_REG_
  `endif // not def ENABLE_INITIAL_REG_
`endif // not def SYNTHESIS

// Include rmemory initializers in init blocks unless synthesis is set
`ifndef SYNTHESIS
  `ifndef ENABLE_INITIAL_MEM_
    `define ENABLE_INITIAL_MEM_
  `endif // not def ENABLE_INITIAL_MEM_
`endif // not def SYNTHESIS

// Standard header to adapt well known macros for prints and assertions.

// Users can define 'PRINTF_COND' to add an extra gate to prints.
`ifndef PRINTF_COND_
  `ifdef PRINTF_COND
    `define PRINTF_COND_ (`PRINTF_COND)
  `else  // PRINTF_COND
    `define PRINTF_COND_ 1
  `endif // PRINTF_COND
`endif // not def PRINTF_COND_

// Users can define 'ASSERT_VERBOSE_COND' to add an extra gate to assert error printing.
`ifndef ASSERT_VERBOSE_COND_
  `ifdef ASSERT_VERBOSE_COND
    `define ASSERT_VERBOSE_COND_ (`ASSERT_VERBOSE_COND)
  `else  // ASSERT_VERBOSE_COND
    `define ASSERT_VERBOSE_COND_ 1
  `endif // ASSERT_VERBOSE_COND
`endif // not def ASSERT_VERBOSE_COND_

// Users can define 'STOP_COND' to add an extra gate to stop conditions.
`ifndef STOP_COND_
  `ifdef STOP_COND
    `define STOP_COND_ (`STOP_COND)
  `else  // STOP_COND
    `define STOP_COND_ 1
  `endif // STOP_COND
`endif // not def STOP_COND_

module PhitArbiter(
  input  clock,
  input  reset,
  output io_in_0_ready,	// @[generators/testchipip/src/main/scala/serdes/Serdes.scala:141:14]
  input  io_in_0_valid,	// @[generators/testchipip/src/main/scala/serdes/Serdes.scala:141:14]
  input  io_in_0_bits_phit,	// @[generators/testchipip/src/main/scala/serdes/Serdes.scala:141:14]
  output io_in_1_ready,	// @[generators/testchipip/src/main/scala/serdes/Serdes.scala:141:14]
  input  io_in_1_valid,	// @[generators/testchipip/src/main/scala/serdes/Serdes.scala:141:14]
  input  io_in_1_bits_phit,	// @[generators/testchipip/src/main/scala/serdes/Serdes.scala:141:14]
  output io_in_2_ready,	// @[generators/testchipip/src/main/scala/serdes/Serdes.scala:141:14]
  input  io_in_2_valid,	// @[generators/testchipip/src/main/scala/serdes/Serdes.scala:141:14]
  input  io_in_2_bits_phit,	// @[generators/testchipip/src/main/scala/serdes/Serdes.scala:141:14]
  output io_in_3_ready,	// @[generators/testchipip/src/main/scala/serdes/Serdes.scala:141:14]
  input  io_in_3_valid,	// @[generators/testchipip/src/main/scala/serdes/Serdes.scala:141:14]
  input  io_in_3_bits_phit,	// @[generators/testchipip/src/main/scala/serdes/Serdes.scala:141:14]
  output io_in_4_ready,	// @[generators/testchipip/src/main/scala/serdes/Serdes.scala:141:14]
  input  io_in_4_valid,	// @[generators/testchipip/src/main/scala/serdes/Serdes.scala:141:14]
  input  io_in_4_bits_phit,	// @[generators/testchipip/src/main/scala/serdes/Serdes.scala:141:14]
  input  io_out_ready,	// @[generators/testchipip/src/main/scala/serdes/Serdes.scala:141:14]
  output io_out_valid,	// @[generators/testchipip/src/main/scala/serdes/Serdes.scala:141:14]
  output io_out_bits_phit	// @[generators/testchipip/src/main/scala/serdes/Serdes.scala:141:14]
);

  reg  [4:0] beat;	// @[generators/testchipip/src/main/scala/serdes/Serdes.scala:152:23]
  reg  [2:0] chosen_reg;	// @[generators/testchipip/src/main/scala/serdes/Serdes.scala:153:25]
  wire [2:0] chosen_prio = io_in_0_valid ? 3'h0 : io_in_1_valid ? 3'h1 : io_in_2_valid ? 3'h2 : io_in_3_valid ? 3'h3 : 3'h4;	// @[generators/testchipip/src/main/scala/serdes/Serdes.scala:163:77, src/main/scala/chisel3/util/Mux.scala:50:70]
  wire       _chosen_T = beat == 5'h0;	// @[generators/testchipip/src/main/scala/serdes/Serdes.scala:152:23, :155:27]
  wire [2:0] chosen = _chosen_T ? chosen_prio : chosen_reg;	// @[generators/testchipip/src/main/scala/serdes/Serdes.scala:153:25, :155:{21,27}, src/main/scala/chisel3/util/Mux.scala:50:70]
  wire [7:0] _GEN = {{io_in_0_valid}, {io_in_0_valid}, {io_in_0_valid}, {io_in_4_valid}, {io_in_3_valid}, {io_in_2_valid}, {io_in_1_valid}, {io_in_0_valid}};	// @[generators/testchipip/src/main/scala/serdes/Serdes.scala:157:18]
  wire [3:0] _GEN_0 = {{chosen[0]}, {chosen[2]}, {chosen[1]}, {chosen[0]}};	// @[generators/testchipip/src/main/scala/serdes/Serdes.scala:155:21, :158:28, :159:22]
  wire [7:0] _GEN_1 = {{io_in_0_bits_phit}, {io_in_0_bits_phit}, {io_in_0_bits_phit}, {io_in_4_bits_phit}, {io_in_3_bits_phit}, {io_in_2_bits_phit}, {io_in_1_bits_phit}, {io_in_0_bits_phit}};	// @[generators/testchipip/src/main/scala/serdes/Serdes.scala:158:28]
  wire       _io_in_4_ready_T = beat > 5'h2;	// @[generators/testchipip/src/main/scala/serdes/Serdes.scala:152:23, :163:46]
  wire       _GEN_2 = io_out_ready & _GEN[chosen];	// @[generators/testchipip/src/main/scala/serdes/Serdes.scala:155:21, :157:18, src/main/scala/chisel3/util/Decoupled.scala:52:35]
  always @(posedge clock) begin
    if (reset)
      beat <= 5'h0;	// @[generators/testchipip/src/main/scala/serdes/Serdes.scala:152:23]
    else if (_GEN_2) begin	// @[src/main/scala/chisel3/util/Decoupled.scala:52:35]
      if (beat == 5'h12)	// @[generators/testchipip/src/main/scala/serdes/Serdes.scala:152:23, :167:24]
        beat <= 5'h0;	// @[generators/testchipip/src/main/scala/serdes/Serdes.scala:152:23]
      else	// @[generators/testchipip/src/main/scala/serdes/Serdes.scala:167:24]
        beat <= beat + 5'h1;	// @[generators/testchipip/src/main/scala/serdes/Serdes.scala:152:23, :167:51]
    end
    if (_GEN_2 & _chosen_T)	// @[generators/testchipip/src/main/scala/serdes/Serdes.scala:153:25, :155:27, :166:24, :168:{27,40}, src/main/scala/chisel3/util/Decoupled.scala:52:35]
      chosen_reg <= chosen_prio;	// @[generators/testchipip/src/main/scala/serdes/Serdes.scala:153:25, src/main/scala/chisel3/util/Mux.scala:50:70]
  end // always @(posedge)
  `ifdef ENABLE_INITIAL_REG_
    `ifdef FIRRTL_BEFORE_INITIAL
      `FIRRTL_BEFORE_INITIAL
    `endif // FIRRTL_BEFORE_INITIAL
    logic [31:0] _RANDOM[0:0];
    initial begin
      `ifdef INIT_RANDOM_PROLOG_
        `INIT_RANDOM_PROLOG_
      `endif // INIT_RANDOM_PROLOG_
      `ifdef RANDOMIZE_REG_INIT
        _RANDOM[/*Zero width*/ 1'b0] = `RANDOM;
        beat = _RANDOM[/*Zero width*/ 1'b0][4:0];	// @[generators/testchipip/src/main/scala/serdes/Serdes.scala:152:23]
        chosen_reg = _RANDOM[/*Zero width*/ 1'b0][7:5];	// @[generators/testchipip/src/main/scala/serdes/Serdes.scala:152:23, :153:25]
      `endif // RANDOMIZE_REG_INIT
    end // initial
    `ifdef FIRRTL_AFTER_INITIAL
      `FIRRTL_AFTER_INITIAL
    `endif // FIRRTL_AFTER_INITIAL
  `endif // ENABLE_INITIAL_REG_
  assign io_in_0_ready = io_out_ready & _io_in_4_ready_T & chosen_reg == 3'h0;	// @[generators/testchipip/src/main/scala/serdes/Serdes.scala:153:25, :163:{38,46,63,77}]
  assign io_in_1_ready = io_out_ready & _io_in_4_ready_T & chosen_reg == 3'h1;	// @[generators/testchipip/src/main/scala/serdes/Serdes.scala:153:25, :163:{38,46,63,77}]
  assign io_in_2_ready = io_out_ready & _io_in_4_ready_T & chosen_reg == 3'h2;	// @[generators/testchipip/src/main/scala/serdes/Serdes.scala:153:25, :163:{38,46,63,77}]
  assign io_in_3_ready = io_out_ready & _io_in_4_ready_T & chosen_reg == 3'h3;	// @[generators/testchipip/src/main/scala/serdes/Serdes.scala:153:25, :163:{38,46,63,77}]
  assign io_in_4_ready = io_out_ready & _io_in_4_ready_T & chosen_reg == 3'h4;	// @[generators/testchipip/src/main/scala/serdes/Serdes.scala:153:25, :163:{38,46,63,77}]
  assign io_out_valid = _GEN[chosen];	// @[generators/testchipip/src/main/scala/serdes/Serdes.scala:155:21, :157:18]
  assign io_out_bits_phit = beat < 5'h3 ? _GEN_0[beat[1:0]] : _GEN_1[chosen];	// @[generators/testchipip/src/main/scala/serdes/Serdes.scala:152:23, :155:21, :158:{28,34}]
endmodule

