// Generated by CIRCT firtool-1.66.0
// Standard header to adapt well known macros for register randomization.
`ifndef RANDOMIZE
  `ifdef RANDOMIZE_MEM_INIT
    `define RANDOMIZE
  `endif // RANDOMIZE_MEM_INIT
`endif // not def RANDOMIZE
`ifndef RANDOMIZE
  `ifdef RANDOMIZE_REG_INIT
    `define RANDOMIZE
  `endif // RANDOMIZE_REG_INIT
`endif // not def RANDOMIZE

// RANDOM may be set to an expression that produces a 32-bit random unsigned value.
`ifndef RANDOM
  `define RANDOM $random
`endif // not def RANDOM

// Users can define INIT_RANDOM as general code that gets injected into the
// initializer block for modules with registers.
`ifndef INIT_RANDOM
  `define INIT_RANDOM
`endif // not def INIT_RANDOM

// If using random initialization, you can also define RANDOMIZE_DELAY to
// customize the delay used, otherwise 0.002 is used.
`ifndef RANDOMIZE_DELAY
  `define RANDOMIZE_DELAY 0.002
`endif // not def RANDOMIZE_DELAY

// Define INIT_RANDOM_PROLOG_ for use in our modules below.
`ifndef INIT_RANDOM_PROLOG_
  `ifdef RANDOMIZE
    `ifdef VERILATOR
      `define INIT_RANDOM_PROLOG_ `INIT_RANDOM
    `else  // VERILATOR
      `define INIT_RANDOM_PROLOG_ `INIT_RANDOM #`RANDOMIZE_DELAY begin end
    `endif // VERILATOR
  `else  // RANDOMIZE
    `define INIT_RANDOM_PROLOG_
  `endif // RANDOMIZE
`endif // not def INIT_RANDOM_PROLOG_

// Include register initializers in init blocks unless synthesis is set
`ifndef SYNTHESIS
  `ifndef ENABLE_INITIAL_REG_
    `define ENABLE_INITIAL_REG_
  `endif // not def ENABLE_INITIAL_REG_
`endif // not def SYNTHESIS

// Include rmemory initializers in init blocks unless synthesis is set
`ifndef SYNTHESIS
  `ifndef ENABLE_INITIAL_MEM_
    `define ENABLE_INITIAL_MEM_
  `endif // not def ENABLE_INITIAL_MEM_
`endif // not def SYNTHESIS

// Standard header to adapt well known macros for prints and assertions.

// Users can define 'PRINTF_COND' to add an extra gate to prints.
`ifndef PRINTF_COND_
  `ifdef PRINTF_COND
    `define PRINTF_COND_ (`PRINTF_COND)
  `else  // PRINTF_COND
    `define PRINTF_COND_ 1
  `endif // PRINTF_COND
`endif // not def PRINTF_COND_

// Users can define 'ASSERT_VERBOSE_COND' to add an extra gate to assert error printing.
`ifndef ASSERT_VERBOSE_COND_
  `ifdef ASSERT_VERBOSE_COND
    `define ASSERT_VERBOSE_COND_ (`ASSERT_VERBOSE_COND)
  `else  // ASSERT_VERBOSE_COND
    `define ASSERT_VERBOSE_COND_ 1
  `endif // ASSERT_VERBOSE_COND
`endif // not def ASSERT_VERBOSE_COND_

// Users can define 'STOP_COND' to add an extra gate to stop conditions.
`ifndef STOP_COND_
  `ifdef STOP_COND
    `define STOP_COND_ (`STOP_COND)
  `else  // STOP_COND
    `define STOP_COND_ 1
  `endif // STOP_COND
`endif // not def STOP_COND_

module PhitDemux(
  input  clock,
  input  reset,
  output io_in_ready,	// @[generators/testchipip/src/main/scala/serdes/Serdes.scala:174:14]
  input  io_in_valid,	// @[generators/testchipip/src/main/scala/serdes/Serdes.scala:174:14]
  input  io_in_bits_phit,	// @[generators/testchipip/src/main/scala/serdes/Serdes.scala:174:14]
  input  io_out_0_ready,	// @[generators/testchipip/src/main/scala/serdes/Serdes.scala:174:14]
  output io_out_0_valid,	// @[generators/testchipip/src/main/scala/serdes/Serdes.scala:174:14]
  output io_out_0_bits_phit,	// @[generators/testchipip/src/main/scala/serdes/Serdes.scala:174:14]
  input  io_out_1_ready,	// @[generators/testchipip/src/main/scala/serdes/Serdes.scala:174:14]
  output io_out_1_valid,	// @[generators/testchipip/src/main/scala/serdes/Serdes.scala:174:14]
  output io_out_1_bits_phit,	// @[generators/testchipip/src/main/scala/serdes/Serdes.scala:174:14]
  input  io_out_2_ready,	// @[generators/testchipip/src/main/scala/serdes/Serdes.scala:174:14]
  output io_out_2_valid,	// @[generators/testchipip/src/main/scala/serdes/Serdes.scala:174:14]
  output io_out_2_bits_phit,	// @[generators/testchipip/src/main/scala/serdes/Serdes.scala:174:14]
  input  io_out_3_ready,	// @[generators/testchipip/src/main/scala/serdes/Serdes.scala:174:14]
  output io_out_3_valid,	// @[generators/testchipip/src/main/scala/serdes/Serdes.scala:174:14]
  output io_out_3_bits_phit,	// @[generators/testchipip/src/main/scala/serdes/Serdes.scala:174:14]
  input  io_out_4_ready,	// @[generators/testchipip/src/main/scala/serdes/Serdes.scala:174:14]
  output io_out_4_valid,	// @[generators/testchipip/src/main/scala/serdes/Serdes.scala:174:14]
  output io_out_4_bits_phit	// @[generators/testchipip/src/main/scala/serdes/Serdes.scala:174:14]
);

  reg  [4:0] beat;	// @[generators/testchipip/src/main/scala/serdes/Serdes.scala:185:23]
  reg        channel_vec_0;	// @[generators/testchipip/src/main/scala/serdes/Serdes.scala:186:26]
  reg        channel_vec_1;	// @[generators/testchipip/src/main/scala/serdes/Serdes.scala:186:26]
  reg        channel_vec_2;	// @[generators/testchipip/src/main/scala/serdes/Serdes.scala:186:26]
  wire [2:0] channel = {channel_vec_2, channel_vec_1, channel_vec_0};	// @[generators/testchipip/src/main/scala/serdes/Serdes.scala:186:26, :187:31]
  wire       _io_in_ready_T = beat < 5'h3;	// @[generators/testchipip/src/main/scala/serdes/Serdes.scala:185:23, :189:25]
  wire [7:0] _GEN = {{io_out_0_ready}, {io_out_0_ready}, {io_out_0_ready}, {io_out_4_ready}, {io_out_3_ready}, {io_out_2_ready}, {io_out_1_ready}, {io_out_0_ready}};	// @[generators/testchipip/src/main/scala/serdes/Serdes.scala:189:41]
  wire       io_in_ready_0 = _io_in_ready_T | _GEN[channel];	// @[generators/testchipip/src/main/scala/serdes/Serdes.scala:187:31, :189:{25,41}]
  wire       _io_out_4_valid_T = beat > 5'h2;	// @[generators/testchipip/src/main/scala/serdes/Serdes.scala:185:23, :191:46]
  wire       _GEN_0 = io_in_ready_0 & io_in_valid;	// @[generators/testchipip/src/main/scala/serdes/Serdes.scala:189:41, src/main/scala/chisel3/util/Decoupled.scala:52:35]
  always @(posedge clock) begin
    if (reset)
      beat <= 5'h0;	// @[generators/testchipip/src/main/scala/serdes/Serdes.scala:185:23]
    else if (_GEN_0) begin	// @[src/main/scala/chisel3/util/Decoupled.scala:52:35]
      if (beat == 5'h12)	// @[generators/testchipip/src/main/scala/serdes/Serdes.scala:185:23, :196:24]
        beat <= 5'h0;	// @[generators/testchipip/src/main/scala/serdes/Serdes.scala:185:23]
      else	// @[generators/testchipip/src/main/scala/serdes/Serdes.scala:196:24]
        beat <= beat + 5'h1;	// @[generators/testchipip/src/main/scala/serdes/Serdes.scala:185:23, :196:51]
    end
    if (_GEN_0 & _io_in_ready_T & beat[1:0] == 2'h0)	// @[generators/testchipip/src/main/scala/serdes/Serdes.scala:185:23, :186:26, :189:25, :191:74, :195:23, :197:35, :198:27, src/main/scala/chisel3/util/Decoupled.scala:52:35]
      channel_vec_0 <= io_in_bits_phit;	// @[generators/testchipip/src/main/scala/serdes/Serdes.scala:186:26]
    if (_GEN_0 & _io_in_ready_T & beat[1:0] == 2'h1)	// @[generators/testchipip/src/main/scala/serdes/Serdes.scala:185:23, :186:26, :189:25, :195:23, :197:35, :198:27, src/main/scala/chisel3/util/Decoupled.scala:52:35]
      channel_vec_1 <= io_in_bits_phit;	// @[generators/testchipip/src/main/scala/serdes/Serdes.scala:186:26]
    if (_GEN_0 & _io_in_ready_T & beat[1:0] == 2'h2)	// @[generators/testchipip/src/main/scala/serdes/Serdes.scala:185:23, :186:26, :189:25, :195:23, :197:35, :198:27, src/main/scala/chisel3/util/Decoupled.scala:52:35]
      channel_vec_2 <= io_in_bits_phit;	// @[generators/testchipip/src/main/scala/serdes/Serdes.scala:186:26]
  end // always @(posedge)
  `ifdef ENABLE_INITIAL_REG_
    `ifdef FIRRTL_BEFORE_INITIAL
      `FIRRTL_BEFORE_INITIAL
    `endif // FIRRTL_BEFORE_INITIAL
    logic [31:0] _RANDOM[0:0];
    initial begin
      `ifdef INIT_RANDOM_PROLOG_
        `INIT_RANDOM_PROLOG_
      `endif // INIT_RANDOM_PROLOG_
      `ifdef RANDOMIZE_REG_INIT
        _RANDOM[/*Zero width*/ 1'b0] = `RANDOM;
        beat = _RANDOM[/*Zero width*/ 1'b0][4:0];	// @[generators/testchipip/src/main/scala/serdes/Serdes.scala:185:23]
        channel_vec_0 = _RANDOM[/*Zero width*/ 1'b0][5];	// @[generators/testchipip/src/main/scala/serdes/Serdes.scala:185:23, :186:26]
        channel_vec_1 = _RANDOM[/*Zero width*/ 1'b0][6];	// @[generators/testchipip/src/main/scala/serdes/Serdes.scala:185:23, :186:26]
        channel_vec_2 = _RANDOM[/*Zero width*/ 1'b0][7];	// @[generators/testchipip/src/main/scala/serdes/Serdes.scala:185:23, :186:26]
      `endif // RANDOMIZE_REG_INIT
    end // initial
    `ifdef FIRRTL_AFTER_INITIAL
      `FIRRTL_AFTER_INITIAL
    `endif // FIRRTL_AFTER_INITIAL
  `endif // ENABLE_INITIAL_REG_
  assign io_in_ready = io_in_ready_0;	// @[generators/testchipip/src/main/scala/serdes/Serdes.scala:189:41]
  assign io_out_0_valid = io_in_valid & _io_out_4_valid_T & channel == 3'h0;	// @[generators/testchipip/src/main/scala/serdes/Serdes.scala:187:31, :189:25, :191:{38,46,63,74}]
  assign io_out_0_bits_phit = io_in_bits_phit;
  assign io_out_1_valid = io_in_valid & _io_out_4_valid_T & channel == 3'h1;	// @[generators/testchipip/src/main/scala/serdes/Serdes.scala:187:31, :191:{38,46,63,74}]
  assign io_out_1_bits_phit = io_in_bits_phit;
  assign io_out_2_valid = io_in_valid & _io_out_4_valid_T & channel == 3'h2;	// @[generators/testchipip/src/main/scala/serdes/Serdes.scala:187:31, :191:{38,46,63,74}]
  assign io_out_2_bits_phit = io_in_bits_phit;
  assign io_out_3_valid = io_in_valid & _io_out_4_valid_T & channel == 3'h3;	// @[generators/testchipip/src/main/scala/serdes/Serdes.scala:187:31, :191:{38,46,63,74}]
  assign io_out_3_bits_phit = io_in_bits_phit;
  assign io_out_4_valid = io_in_valid & _io_out_4_valid_T & channel == 3'h4;	// @[generators/testchipip/src/main/scala/serdes/Serdes.scala:187:31, :191:{38,46,63,74}]
  assign io_out_4_bits_phit = io_in_bits_phit;
endmodule

