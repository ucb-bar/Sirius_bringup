// Generated by CIRCT firtool-1.66.0
// Standard header to adapt well known macros for register randomization.
`ifndef RANDOMIZE
  `ifdef RANDOMIZE_MEM_INIT
    `define RANDOMIZE
  `endif // RANDOMIZE_MEM_INIT
`endif // not def RANDOMIZE
`ifndef RANDOMIZE
  `ifdef RANDOMIZE_REG_INIT
    `define RANDOMIZE
  `endif // RANDOMIZE_REG_INIT
`endif // not def RANDOMIZE

// RANDOM may be set to an expression that produces a 32-bit random unsigned value.
`ifndef RANDOM
  `define RANDOM $random
`endif // not def RANDOM

// Users can define INIT_RANDOM as general code that gets injected into the
// initializer block for modules with registers.
`ifndef INIT_RANDOM
  `define INIT_RANDOM
`endif // not def INIT_RANDOM

// If using random initialization, you can also define RANDOMIZE_DELAY to
// customize the delay used, otherwise 0.002 is used.
`ifndef RANDOMIZE_DELAY
  `define RANDOMIZE_DELAY 0.002
`endif // not def RANDOMIZE_DELAY

// Define INIT_RANDOM_PROLOG_ for use in our modules below.
`ifndef INIT_RANDOM_PROLOG_
  `ifdef RANDOMIZE
    `ifdef VERILATOR
      `define INIT_RANDOM_PROLOG_ `INIT_RANDOM
    `else  // VERILATOR
      `define INIT_RANDOM_PROLOG_ `INIT_RANDOM #`RANDOMIZE_DELAY begin end
    `endif // VERILATOR
  `else  // RANDOMIZE
    `define INIT_RANDOM_PROLOG_
  `endif // RANDOMIZE
`endif // not def INIT_RANDOM_PROLOG_

// Include register initializers in init blocks unless synthesis is set
`ifndef SYNTHESIS
  `ifndef ENABLE_INITIAL_REG_
    `define ENABLE_INITIAL_REG_
  `endif // not def ENABLE_INITIAL_REG_
`endif // not def SYNTHESIS

// Include rmemory initializers in init blocks unless synthesis is set
`ifndef SYNTHESIS
  `ifndef ENABLE_INITIAL_MEM_
    `define ENABLE_INITIAL_MEM_
  `endif // not def ENABLE_INITIAL_MEM_
`endif // not def SYNTHESIS

// Standard header to adapt well known macros for prints and assertions.

// Users can define 'PRINTF_COND' to add an extra gate to prints.
`ifndef PRINTF_COND_
  `ifdef PRINTF_COND
    `define PRINTF_COND_ (`PRINTF_COND)
  `else  // PRINTF_COND
    `define PRINTF_COND_ 1
  `endif // PRINTF_COND
`endif // not def PRINTF_COND_

// Users can define 'ASSERT_VERBOSE_COND' to add an extra gate to assert error printing.
`ifndef ASSERT_VERBOSE_COND_
  `ifdef ASSERT_VERBOSE_COND
    `define ASSERT_VERBOSE_COND_ (`ASSERT_VERBOSE_COND)
  `else  // ASSERT_VERBOSE_COND
    `define ASSERT_VERBOSE_COND_ 1
  `endif // ASSERT_VERBOSE_COND
`endif // not def ASSERT_VERBOSE_COND_

// Users can define 'STOP_COND' to add an extra gate to stop conditions.
`ifndef STOP_COND_
  `ifdef STOP_COND
    `define STOP_COND_ (`STOP_COND)
  `else  // STOP_COND
    `define STOP_COND_ 1
  `endif // STOP_COND
`endif // not def STOP_COND_

module GenericSerializer_2(
  input         clock,
  input         reset,
  output        io_in_ready,	// @[generators/testchipip/src/main/scala/serdes/Serdes.scala:9:14]
  input         io_in_valid,	// @[generators/testchipip/src/main/scala/serdes/Serdes.scala:9:14]
  input  [85:0] io_in_bits_payload,	// @[generators/testchipip/src/main/scala/serdes/Serdes.scala:9:14]
  input         io_in_bits_head,	// @[generators/testchipip/src/main/scala/serdes/Serdes.scala:9:14]
  input         io_in_bits_tail,	// @[generators/testchipip/src/main/scala/serdes/Serdes.scala:9:14]
  input         io_out_ready,	// @[generators/testchipip/src/main/scala/serdes/Serdes.scala:9:14]
  output        io_out_valid,	// @[generators/testchipip/src/main/scala/serdes/Serdes.scala:9:14]
  output [15:0] io_out_bits_flit	// @[generators/testchipip/src/main/scala/serdes/Serdes.scala:9:14]
);

  wire [1:0][15:0] _GEN = '{16'h0, 16'h0};
  reg  [15:0]      data_1;	// @[generators/testchipip/src/main/scala/serdes/Serdes.scala:18:17]
  reg  [15:0]      data_2;	// @[generators/testchipip/src/main/scala/serdes/Serdes.scala:18:17]
  reg  [15:0]      data_3;	// @[generators/testchipip/src/main/scala/serdes/Serdes.scala:18:17]
  reg  [15:0]      data_4;	// @[generators/testchipip/src/main/scala/serdes/Serdes.scala:18:17]
  reg  [15:0]      data_5;	// @[generators/testchipip/src/main/scala/serdes/Serdes.scala:18:17]
  reg  [2:0]       beat;	// @[generators/testchipip/src/main/scala/serdes/Serdes.scala:19:21]
  wire             _io_out_bits_flit_T = beat == 3'h0;	// @[generators/testchipip/src/main/scala/serdes/Serdes.scala:19:21, :21:39]
  wire             io_out_valid_0 = io_in_valid | (|beat);	// @[generators/testchipip/src/main/scala/serdes/Serdes.scala:19:21, :22:{31,39}]
  wire [7:0][15:0] _GEN_0 = {_GEN, {{data_5}, {data_4}, {data_3}, {data_2}, {data_1}, {16'h0}}};	// @[generators/testchipip/src/main/scala/serdes/Serdes.scala:18:17, :23:26]
  wire             _GEN_1 = io_out_ready & io_out_valid_0;	// @[generators/testchipip/src/main/scala/serdes/Serdes.scala:22:31, src/main/scala/chisel3/util/Decoupled.scala:52:35]
  always @(posedge clock) begin
    if (_GEN_1 & _io_out_bits_flit_T) begin	// @[generators/testchipip/src/main/scala/serdes/Serdes.scala:18:17, :21:39, :25:22, :27:25, :28:12, src/main/scala/chisel3/util/Decoupled.scala:52:35]
      data_1 <= io_in_bits_payload[29:14];	// @[generators/testchipip/src/main/scala/serdes/Serdes.scala:18:17, :28:34]
      data_2 <= io_in_bits_payload[45:30];	// @[generators/testchipip/src/main/scala/serdes/Serdes.scala:18:17, :28:34]
      data_3 <= io_in_bits_payload[61:46];	// @[generators/testchipip/src/main/scala/serdes/Serdes.scala:18:17, :28:34]
      data_4 <= io_in_bits_payload[77:62];	// @[generators/testchipip/src/main/scala/serdes/Serdes.scala:18:17, :28:34]
      data_5 <= {8'h0, io_in_bits_payload[85:78]};	// @[generators/testchipip/src/main/scala/serdes/Serdes.scala:18:17, :28:34]
    end
    if (reset)
      beat <= 3'h0;	// @[generators/testchipip/src/main/scala/serdes/Serdes.scala:19:21]
    else if (_GEN_1) begin	// @[src/main/scala/chisel3/util/Decoupled.scala:52:35]
      if (beat == 3'h5)	// @[generators/testchipip/src/main/scala/serdes/Serdes.scala:19:21, :26:22]
        beat <= 3'h0;	// @[generators/testchipip/src/main/scala/serdes/Serdes.scala:19:21]
      else	// @[generators/testchipip/src/main/scala/serdes/Serdes.scala:26:22]
        beat <= beat + 3'h1;	// @[generators/testchipip/src/main/scala/serdes/Serdes.scala:19:21, :26:53]
    end
  end // always @(posedge)
  `ifdef ENABLE_INITIAL_REG_
    `ifdef FIRRTL_BEFORE_INITIAL
      `FIRRTL_BEFORE_INITIAL
    `endif // FIRRTL_BEFORE_INITIAL
    logic [31:0] _RANDOM[0:3];
    initial begin
      `ifdef INIT_RANDOM_PROLOG_
        `INIT_RANDOM_PROLOG_
      `endif // INIT_RANDOM_PROLOG_
      `ifdef RANDOMIZE_REG_INIT
        for (logic [2:0] i = 3'h0; i < 3'h4; i += 3'h1) begin
          _RANDOM[i[1:0]] = `RANDOM;
        end
        data_1 = _RANDOM[2'h0][31:16];	// @[generators/testchipip/src/main/scala/serdes/Serdes.scala:18:17]
        data_2 = _RANDOM[2'h1][15:0];	// @[generators/testchipip/src/main/scala/serdes/Serdes.scala:18:17]
        data_3 = _RANDOM[2'h1][31:16];	// @[generators/testchipip/src/main/scala/serdes/Serdes.scala:18:17]
        data_4 = _RANDOM[2'h2][15:0];	// @[generators/testchipip/src/main/scala/serdes/Serdes.scala:18:17]
        data_5 = _RANDOM[2'h2][31:16];	// @[generators/testchipip/src/main/scala/serdes/Serdes.scala:18:17]
        beat = _RANDOM[2'h3][2:0];	// @[generators/testchipip/src/main/scala/serdes/Serdes.scala:19:21]
      `endif // RANDOMIZE_REG_INIT
    end // initial
    `ifdef FIRRTL_AFTER_INITIAL
      `FIRRTL_AFTER_INITIAL
    `endif // FIRRTL_AFTER_INITIAL
  `endif // ENABLE_INITIAL_REG_
  assign io_in_ready = io_out_ready & _io_out_bits_flit_T;	// @[generators/testchipip/src/main/scala/serdes/Serdes.scala:21:{31,39}]
  assign io_out_valid = io_out_valid_0;	// @[generators/testchipip/src/main/scala/serdes/Serdes.scala:22:31]
  assign io_out_bits_flit = _io_out_bits_flit_T ? {io_in_bits_payload[13:0], io_in_bits_head, io_in_bits_tail} : _GEN_0[beat];	// @[generators/testchipip/src/main/scala/serdes/Serdes.scala:19:21, :21:39, :23:{26,52}]
endmodule

