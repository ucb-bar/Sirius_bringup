// Generated by CIRCT firtool-1.66.0
// Standard header to adapt well known macros for register randomization.
`ifndef RANDOMIZE
  `ifdef RANDOMIZE_MEM_INIT
    `define RANDOMIZE
  `endif // RANDOMIZE_MEM_INIT
`endif // not def RANDOMIZE
`ifndef RANDOMIZE
  `ifdef RANDOMIZE_REG_INIT
    `define RANDOMIZE
  `endif // RANDOMIZE_REG_INIT
`endif // not def RANDOMIZE

// RANDOM may be set to an expression that produces a 32-bit random unsigned value.
`ifndef RANDOM
  `define RANDOM $random
`endif // not def RANDOM

// Users can define INIT_RANDOM as general code that gets injected into the
// initializer block for modules with registers.
`ifndef INIT_RANDOM
  `define INIT_RANDOM
`endif // not def INIT_RANDOM

// If using random initialization, you can also define RANDOMIZE_DELAY to
// customize the delay used, otherwise 0.002 is used.
`ifndef RANDOMIZE_DELAY
  `define RANDOMIZE_DELAY 0.002
`endif // not def RANDOMIZE_DELAY

// Define INIT_RANDOM_PROLOG_ for use in our modules below.
`ifndef INIT_RANDOM_PROLOG_
  `ifdef RANDOMIZE
    `ifdef VERILATOR
      `define INIT_RANDOM_PROLOG_ `INIT_RANDOM
    `else  // VERILATOR
      `define INIT_RANDOM_PROLOG_ `INIT_RANDOM #`RANDOMIZE_DELAY begin end
    `endif // VERILATOR
  `else  // RANDOMIZE
    `define INIT_RANDOM_PROLOG_
  `endif // RANDOMIZE
`endif // not def INIT_RANDOM_PROLOG_

// Include register initializers in init blocks unless synthesis is set
`ifndef SYNTHESIS
  `ifndef ENABLE_INITIAL_REG_
    `define ENABLE_INITIAL_REG_
  `endif // not def ENABLE_INITIAL_REG_
`endif // not def SYNTHESIS

// Include rmemory initializers in init blocks unless synthesis is set
`ifndef SYNTHESIS
  `ifndef ENABLE_INITIAL_MEM_
    `define ENABLE_INITIAL_MEM_
  `endif // not def ENABLE_INITIAL_MEM_
`endif // not def SYNTHESIS

// Standard header to adapt well known macros for prints and assertions.

// Users can define 'PRINTF_COND' to add an extra gate to prints.
`ifndef PRINTF_COND_
  `ifdef PRINTF_COND
    `define PRINTF_COND_ (`PRINTF_COND)
  `else  // PRINTF_COND
    `define PRINTF_COND_ 1
  `endif // PRINTF_COND
`endif // not def PRINTF_COND_

// Users can define 'ASSERT_VERBOSE_COND' to add an extra gate to assert error printing.
`ifndef ASSERT_VERBOSE_COND_
  `ifdef ASSERT_VERBOSE_COND
    `define ASSERT_VERBOSE_COND_ (`ASSERT_VERBOSE_COND)
  `else  // ASSERT_VERBOSE_COND
    `define ASSERT_VERBOSE_COND_ 1
  `endif // ASSERT_VERBOSE_COND
`endif // not def ASSERT_VERBOSE_COND_

// Users can define 'STOP_COND' to add an extra gate to stop conditions.
`ifndef STOP_COND_
  `ifdef STOP_COND
    `define STOP_COND_ (`STOP_COND)
  `else  // STOP_COND
    `define STOP_COND_ 1
  `endif // STOP_COND
`endif // not def STOP_COND_

module SerialWidthAggregator(
  input         clock,
  input         reset,
  output        io_narrow_ready,	// @[generators/testchipip/src/main/scala/serdes/Adapter.scala:10:14]
  input         io_narrow_valid,	// @[generators/testchipip/src/main/scala/serdes/Adapter.scala:10:14]
  input  [7:0]  io_narrow_bits,	// @[generators/testchipip/src/main/scala/serdes/Adapter.scala:10:14]
  input         io_wide_ready,	// @[generators/testchipip/src/main/scala/serdes/Adapter.scala:10:14]
  output        io_wide_valid,	// @[generators/testchipip/src/main/scala/serdes/Adapter.scala:10:14]
  output [31:0] io_wide_bits	// @[generators/testchipip/src/main/scala/serdes/Adapter.scala:10:14]
);

  reg  [1:0] narrow_beats;	// @[generators/testchipip/src/main/scala/serdes/Adapter.scala:17:29]
  reg  [7:0] narrow_data_0;	// @[generators/testchipip/src/main/scala/serdes/Adapter.scala:19:24]
  reg  [7:0] narrow_data_1;	// @[generators/testchipip/src/main/scala/serdes/Adapter.scala:19:24]
  reg  [7:0] narrow_data_2;	// @[generators/testchipip/src/main/scala/serdes/Adapter.scala:19:24]
  wire       io_narrow_ready_0 = ~(&narrow_beats) | io_wide_ready;	// @[generators/testchipip/src/main/scala/serdes/Adapter.scala:17:29, :18:39, :21:25]
  wire       _GEN = io_narrow_ready_0 & io_narrow_valid;	// @[generators/testchipip/src/main/scala/serdes/Adapter.scala:21:25, src/main/scala/chisel3/util/Decoupled.scala:52:35]
  always @(posedge clock) begin
    if (reset)
      narrow_beats <= 2'h0;	// @[generators/testchipip/src/main/scala/serdes/Adapter.scala:17:29]
    else if (_GEN) begin	// @[src/main/scala/chisel3/util/Decoupled.scala:52:35]
      if (&narrow_beats)	// @[generators/testchipip/src/main/scala/serdes/Adapter.scala:17:29, :18:39]
        narrow_beats <= 2'h0;	// @[generators/testchipip/src/main/scala/serdes/Adapter.scala:17:29]
      else	// @[generators/testchipip/src/main/scala/serdes/Adapter.scala:18:39]
        narrow_beats <= narrow_beats + 2'h1;	// @[generators/testchipip/src/main/scala/serdes/Adapter.scala:17:29, :23:61]
    end
    if (_GEN & ~(&narrow_beats) & narrow_beats == 2'h0)	// @[generators/testchipip/src/main/scala/serdes/Adapter.scala:17:29, :18:39, :19:24, :22:25, :24:{11,30,58}, src/main/scala/chisel3/util/Decoupled.scala:52:35]
      narrow_data_0 <= io_narrow_bits;	// @[generators/testchipip/src/main/scala/serdes/Adapter.scala:19:24]
    if (_GEN & ~(&narrow_beats) & narrow_beats == 2'h1)	// @[generators/testchipip/src/main/scala/serdes/Adapter.scala:17:29, :18:39, :19:24, :22:25, :24:{11,30,58}, src/main/scala/chisel3/util/Decoupled.scala:52:35]
      narrow_data_1 <= io_narrow_bits;	// @[generators/testchipip/src/main/scala/serdes/Adapter.scala:19:24]
    if (_GEN & ~(&narrow_beats) & narrow_beats == 2'h2)	// @[generators/testchipip/src/main/scala/serdes/Adapter.scala:17:29, :18:39, :19:24, :22:25, :24:{11,30,58}, src/main/scala/chisel3/util/Decoupled.scala:52:35]
      narrow_data_2 <= io_narrow_bits;	// @[generators/testchipip/src/main/scala/serdes/Adapter.scala:19:24]
  end // always @(posedge)
  `ifdef ENABLE_INITIAL_REG_
    `ifdef FIRRTL_BEFORE_INITIAL
      `FIRRTL_BEFORE_INITIAL
    `endif // FIRRTL_BEFORE_INITIAL
    logic [31:0] _RANDOM[0:0];
    initial begin
      `ifdef INIT_RANDOM_PROLOG_
        `INIT_RANDOM_PROLOG_
      `endif // INIT_RANDOM_PROLOG_
      `ifdef RANDOMIZE_REG_INIT
        _RANDOM[/*Zero width*/ 1'b0] = `RANDOM;
        narrow_beats = _RANDOM[/*Zero width*/ 1'b0][1:0];	// @[generators/testchipip/src/main/scala/serdes/Adapter.scala:17:29]
        narrow_data_0 = _RANDOM[/*Zero width*/ 1'b0][9:2];	// @[generators/testchipip/src/main/scala/serdes/Adapter.scala:17:29, :19:24]
        narrow_data_1 = _RANDOM[/*Zero width*/ 1'b0][17:10];	// @[generators/testchipip/src/main/scala/serdes/Adapter.scala:17:29, :19:24]
        narrow_data_2 = _RANDOM[/*Zero width*/ 1'b0][25:18];	// @[generators/testchipip/src/main/scala/serdes/Adapter.scala:17:29, :19:24]
      `endif // RANDOMIZE_REG_INIT
    end // initial
    `ifdef FIRRTL_AFTER_INITIAL
      `FIRRTL_AFTER_INITIAL
    `endif // FIRRTL_AFTER_INITIAL
  `endif // ENABLE_INITIAL_REG_
  assign io_narrow_ready = io_narrow_ready_0;	// @[generators/testchipip/src/main/scala/serdes/Adapter.scala:21:25]
  assign io_wide_valid = (&narrow_beats) & io_narrow_valid;	// @[generators/testchipip/src/main/scala/serdes/Adapter.scala:17:29, :18:39, :26:37]
  assign io_wide_bits = {io_narrow_bits, narrow_data_2, narrow_data_1, narrow_data_0};	// @[generators/testchipip/src/main/scala/serdes/Adapter.scala:19:24, :27:22]
endmodule

