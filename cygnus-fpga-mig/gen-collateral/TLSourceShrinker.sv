// Generated by CIRCT firtool-1.66.0
// Standard header to adapt well known macros for register randomization.
`ifndef RANDOMIZE
  `ifdef RANDOMIZE_MEM_INIT
    `define RANDOMIZE
  `endif // RANDOMIZE_MEM_INIT
`endif // not def RANDOMIZE
`ifndef RANDOMIZE
  `ifdef RANDOMIZE_REG_INIT
    `define RANDOMIZE
  `endif // RANDOMIZE_REG_INIT
`endif // not def RANDOMIZE

// RANDOM may be set to an expression that produces a 32-bit random unsigned value.
`ifndef RANDOM
  `define RANDOM $random
`endif // not def RANDOM

// Users can define INIT_RANDOM as general code that gets injected into the
// initializer block for modules with registers.
`ifndef INIT_RANDOM
  `define INIT_RANDOM
`endif // not def INIT_RANDOM

// If using random initialization, you can also define RANDOMIZE_DELAY to
// customize the delay used, otherwise 0.002 is used.
`ifndef RANDOMIZE_DELAY
  `define RANDOMIZE_DELAY 0.002
`endif // not def RANDOMIZE_DELAY

// Define INIT_RANDOM_PROLOG_ for use in our modules below.
`ifndef INIT_RANDOM_PROLOG_
  `ifdef RANDOMIZE
    `ifdef VERILATOR
      `define INIT_RANDOM_PROLOG_ `INIT_RANDOM
    `else  // VERILATOR
      `define INIT_RANDOM_PROLOG_ `INIT_RANDOM #`RANDOMIZE_DELAY begin end
    `endif // VERILATOR
  `else  // RANDOMIZE
    `define INIT_RANDOM_PROLOG_
  `endif // RANDOMIZE
`endif // not def INIT_RANDOM_PROLOG_

// Include register initializers in init blocks unless synthesis is set
`ifndef SYNTHESIS
  `ifndef ENABLE_INITIAL_REG_
    `define ENABLE_INITIAL_REG_
  `endif // not def ENABLE_INITIAL_REG_
`endif // not def SYNTHESIS

// Include rmemory initializers in init blocks unless synthesis is set
`ifndef SYNTHESIS
  `ifndef ENABLE_INITIAL_MEM_
    `define ENABLE_INITIAL_MEM_
  `endif // not def ENABLE_INITIAL_MEM_
`endif // not def SYNTHESIS

// Standard header to adapt well known macros for prints and assertions.

// Users can define 'PRINTF_COND' to add an extra gate to prints.
`ifndef PRINTF_COND_
  `ifdef PRINTF_COND
    `define PRINTF_COND_ (`PRINTF_COND)
  `else  // PRINTF_COND
    `define PRINTF_COND_ 1
  `endif // PRINTF_COND
`endif // not def PRINTF_COND_

// Users can define 'ASSERT_VERBOSE_COND' to add an extra gate to assert error printing.
`ifndef ASSERT_VERBOSE_COND_
  `ifdef ASSERT_VERBOSE_COND
    `define ASSERT_VERBOSE_COND_ (`ASSERT_VERBOSE_COND)
  `else  // ASSERT_VERBOSE_COND
    `define ASSERT_VERBOSE_COND_ 1
  `endif // ASSERT_VERBOSE_COND
`endif // not def ASSERT_VERBOSE_COND_

// Users can define 'STOP_COND' to add an extra gate to stop conditions.
`ifndef STOP_COND_
  `ifdef STOP_COND
    `define STOP_COND_ (`STOP_COND)
  `else  // STOP_COND
    `define STOP_COND_ 1
  `endif // STOP_COND
`endif // not def STOP_COND_

module TLSourceShrinker(
  input         clock,
  input         reset,
  output        auto_anon_in_a_ready,	// @[generators/diplomacy/diplomacy/src/diplomacy/lazymodule/LazyModuleImp.scala:100:25]
  input         auto_anon_in_a_valid,	// @[generators/diplomacy/diplomacy/src/diplomacy/lazymodule/LazyModuleImp.scala:100:25]
  input  [2:0]  auto_anon_in_a_bits_opcode,	// @[generators/diplomacy/diplomacy/src/diplomacy/lazymodule/LazyModuleImp.scala:100:25]
  input  [2:0]  auto_anon_in_a_bits_param,	// @[generators/diplomacy/diplomacy/src/diplomacy/lazymodule/LazyModuleImp.scala:100:25]
  input  [2:0]  auto_anon_in_a_bits_size,	// @[generators/diplomacy/diplomacy/src/diplomacy/lazymodule/LazyModuleImp.scala:100:25]
  input  [10:0] auto_anon_in_a_bits_source,	// @[generators/diplomacy/diplomacy/src/diplomacy/lazymodule/LazyModuleImp.scala:100:25]
  input  [31:0] auto_anon_in_a_bits_address,	// @[generators/diplomacy/diplomacy/src/diplomacy/lazymodule/LazyModuleImp.scala:100:25]
  input  [7:0]  auto_anon_in_a_bits_mask,	// @[generators/diplomacy/diplomacy/src/diplomacy/lazymodule/LazyModuleImp.scala:100:25]
  input  [63:0] auto_anon_in_a_bits_data,	// @[generators/diplomacy/diplomacy/src/diplomacy/lazymodule/LazyModuleImp.scala:100:25]
  input         auto_anon_in_d_ready,	// @[generators/diplomacy/diplomacy/src/diplomacy/lazymodule/LazyModuleImp.scala:100:25]
  output        auto_anon_in_d_valid,	// @[generators/diplomacy/diplomacy/src/diplomacy/lazymodule/LazyModuleImp.scala:100:25]
  output [2:0]  auto_anon_in_d_bits_opcode,	// @[generators/diplomacy/diplomacy/src/diplomacy/lazymodule/LazyModuleImp.scala:100:25]
  output [1:0]  auto_anon_in_d_bits_param,	// @[generators/diplomacy/diplomacy/src/diplomacy/lazymodule/LazyModuleImp.scala:100:25]
  output [2:0]  auto_anon_in_d_bits_size,	// @[generators/diplomacy/diplomacy/src/diplomacy/lazymodule/LazyModuleImp.scala:100:25]
  output [10:0] auto_anon_in_d_bits_source,	// @[generators/diplomacy/diplomacy/src/diplomacy/lazymodule/LazyModuleImp.scala:100:25]
  output        auto_anon_in_d_bits_denied,	// @[generators/diplomacy/diplomacy/src/diplomacy/lazymodule/LazyModuleImp.scala:100:25]
  output [63:0] auto_anon_in_d_bits_data,	// @[generators/diplomacy/diplomacy/src/diplomacy/lazymodule/LazyModuleImp.scala:100:25]
  output        auto_anon_in_d_bits_corrupt,	// @[generators/diplomacy/diplomacy/src/diplomacy/lazymodule/LazyModuleImp.scala:100:25]
  input         auto_anon_out_a_ready,	// @[generators/diplomacy/diplomacy/src/diplomacy/lazymodule/LazyModuleImp.scala:100:25]
  output        auto_anon_out_a_valid,	// @[generators/diplomacy/diplomacy/src/diplomacy/lazymodule/LazyModuleImp.scala:100:25]
  output [2:0]  auto_anon_out_a_bits_opcode,	// @[generators/diplomacy/diplomacy/src/diplomacy/lazymodule/LazyModuleImp.scala:100:25]
  output [2:0]  auto_anon_out_a_bits_param,	// @[generators/diplomacy/diplomacy/src/diplomacy/lazymodule/LazyModuleImp.scala:100:25]
  output [2:0]  auto_anon_out_a_bits_size,	// @[generators/diplomacy/diplomacy/src/diplomacy/lazymodule/LazyModuleImp.scala:100:25]
  output [3:0]  auto_anon_out_a_bits_source,	// @[generators/diplomacy/diplomacy/src/diplomacy/lazymodule/LazyModuleImp.scala:100:25]
  output [31:0] auto_anon_out_a_bits_address,	// @[generators/diplomacy/diplomacy/src/diplomacy/lazymodule/LazyModuleImp.scala:100:25]
  output [7:0]  auto_anon_out_a_bits_mask,	// @[generators/diplomacy/diplomacy/src/diplomacy/lazymodule/LazyModuleImp.scala:100:25]
  output [63:0] auto_anon_out_a_bits_data,	// @[generators/diplomacy/diplomacy/src/diplomacy/lazymodule/LazyModuleImp.scala:100:25]
  output        auto_anon_out_d_ready,	// @[generators/diplomacy/diplomacy/src/diplomacy/lazymodule/LazyModuleImp.scala:100:25]
  input         auto_anon_out_d_valid,	// @[generators/diplomacy/diplomacy/src/diplomacy/lazymodule/LazyModuleImp.scala:100:25]
  input  [2:0]  auto_anon_out_d_bits_opcode,	// @[generators/diplomacy/diplomacy/src/diplomacy/lazymodule/LazyModuleImp.scala:100:25]
  input  [1:0]  auto_anon_out_d_bits_param,	// @[generators/diplomacy/diplomacy/src/diplomacy/lazymodule/LazyModuleImp.scala:100:25]
  input  [2:0]  auto_anon_out_d_bits_size,	// @[generators/diplomacy/diplomacy/src/diplomacy/lazymodule/LazyModuleImp.scala:100:25]
  input  [3:0]  auto_anon_out_d_bits_source,	// @[generators/diplomacy/diplomacy/src/diplomacy/lazymodule/LazyModuleImp.scala:100:25]
  input         auto_anon_out_d_bits_denied,	// @[generators/diplomacy/diplomacy/src/diplomacy/lazymodule/LazyModuleImp.scala:100:25]
  input  [63:0] auto_anon_out_d_bits_data,	// @[generators/diplomacy/diplomacy/src/diplomacy/lazymodule/LazyModuleImp.scala:100:25]
  input         auto_anon_out_d_bits_corrupt	// @[generators/diplomacy/diplomacy/src/diplomacy/lazymodule/LazyModuleImp.scala:100:25]
);

  wire        anonIn_a_ready;	// @[generators/rocket-chip/src/main/scala/tilelink/SourceShrinker.scala:68:35]
  reg  [15:0] allocated;	// @[generators/rocket-chip/src/main/scala/tilelink/SourceShrinker.scala:59:32]
  wire [15:0] _nextFreeOH_T_16 = ~allocated;	// @[generators/rocket-chip/src/main/scala/tilelink/SourceShrinker.scala:59:32, :60:35]
  wire [14:0] _nextFreeOH_T_3 = _nextFreeOH_T_16[14:0] | {_nextFreeOH_T_16[13:0], 1'h0};	// @[generators/rocket-chip/src/main/scala/tilelink/SourceShrinker.scala:60:35, generators/rocket-chip/src/main/scala/util/package.scala:253:{43,53}]
  wire [14:0] _nextFreeOH_T_6 = _nextFreeOH_T_3 | {_nextFreeOH_T_3[12:0], 2'h0};	// @[generators/rocket-chip/src/main/scala/util/package.scala:253:{43,48,53}]
  wire [14:0] _nextFreeOH_T_9 = _nextFreeOH_T_6 | {_nextFreeOH_T_6[10:0], 4'h0};	// @[generators/rocket-chip/src/main/scala/util/package.scala:253:{43,48,53}]
  wire [15:0] nextFree_lo = {~(_nextFreeOH_T_9 | {_nextFreeOH_T_9[6:0], 8'h0}), 1'h1} & _nextFreeOH_T_16;	// @[generators/rocket-chip/src/main/scala/tilelink/SourceShrinker.scala:60:{26,35,53}, generators/rocket-chip/src/main/scala/util/package.scala:253:{43,48,53}]
  wire [6:0]  _nextFree_T_3 = nextFree_lo[15:9] | nextFree_lo[7:1];	// @[generators/rocket-chip/src/main/scala/tilelink/SourceShrinker.scala:60:53, src/main/scala/chisel3/util/OneHot.scala:30:18, :31:18, :32:28]
  wire [2:0]  _nextFree_T_5 = _nextFree_T_3[6:4] | _nextFree_T_3[2:0];	// @[src/main/scala/chisel3/util/OneHot.scala:30:18, :31:18, :32:28]
  wire        _nextFree_T_7 = _nextFree_T_5[2] | _nextFree_T_5[0];	// @[src/main/scala/chisel3/util/OneHot.scala:30:18, :31:18, :32:28]
  wire        _alloc_T = anonIn_a_ready & auto_anon_in_a_valid;	// @[generators/rocket-chip/src/main/scala/tilelink/SourceShrinker.scala:68:35, src/main/scala/chisel3/util/Decoupled.scala:52:35]
  reg  [2:0]  a_first_counter;	// @[generators/rocket-chip/src/main/scala/tilelink/Edges.scala:229:27]
  wire        a_first = a_first_counter == 3'h0;	// @[generators/rocket-chip/src/main/scala/tilelink/Edges.scala:229:27, :231:25]
  reg  [2:0]  d_last_counter;	// @[generators/rocket-chip/src/main/scala/tilelink/Edges.scala:229:27]
  wire        block = a_first & (&allocated);	// @[generators/rocket-chip/src/main/scala/tilelink/Edges.scala:231:25, generators/rocket-chip/src/main/scala/tilelink/SourceShrinker.scala:59:32, :62:30, :67:29]
  assign anonIn_a_ready = auto_anon_out_a_ready & ~block;	// @[generators/rocket-chip/src/main/scala/tilelink/SourceShrinker.scala:67:29, :68:{35,38}]
  reg  [4:0]  anonOut_a_bits_source_r;	// @[generators/rocket-chip/src/main/scala/util/package.scala:88:63]
  wire [3:0]  _GEN = {|(nextFree_lo[15:8]), |(_nextFree_T_3[6:3]), |(_nextFree_T_5[2:1]), _nextFree_T_7};	// @[generators/rocket-chip/src/main/scala/tilelink/SourceShrinker.scala:60:53, src/main/scala/chisel3/util/OneHot.scala:30:18, :32:{10,14,28}]
  wire [12:0] _a_first_beats1_decode_T_1 = 13'h3F << auto_anon_in_a_bits_size;	// @[generators/rocket-chip/src/main/scala/util/package.scala:243:71]
  wire        _free_T = auto_anon_in_d_ready & auto_anon_out_d_valid;	// @[src/main/scala/chisel3/util/Decoupled.scala:52:35]
  wire [12:0] _d_last_beats1_decode_T_1 = 13'h3F << auto_anon_out_d_bits_size;	// @[generators/rocket-chip/src/main/scala/util/package.scala:243:71]
  wire [2:0]  d_last_beats1 = auto_anon_out_d_bits_opcode[0] ? ~(_d_last_beats1_decode_T_1[5:3]) : 3'h0;	// @[generators/rocket-chip/src/main/scala/tilelink/Edges.scala:106:36, :221:14, generators/rocket-chip/src/main/scala/util/package.scala:243:{46,71,76}]
  always @(posedge clock) begin
    if (reset) begin
      allocated <= 16'h0;	// @[generators/rocket-chip/src/main/scala/tilelink/SourceShrinker.scala:59:32]
      a_first_counter <= 3'h0;	// @[generators/rocket-chip/src/main/scala/tilelink/Edges.scala:229:27]
      d_last_counter <= 3'h0;	// @[generators/rocket-chip/src/main/scala/tilelink/Edges.scala:229:27]
    end
    else begin
      allocated <= (allocated | (a_first & _alloc_T ? nextFree_lo : 16'h0)) & ~((d_last_counter == 3'h1 | d_last_beats1 == 3'h0) & _free_T ? 16'h1 << auto_anon_out_d_bits_source : 16'h0);	// @[generators/rocket-chip/src/main/scala/tilelink/Edges.scala:221:14, :229:27, :231:25, :232:{25,33,43}, generators/rocket-chip/src/main/scala/tilelink/SourceShrinker.scala:59:32, :60:53, :81:29, :82:27, :83:27, :84:26, :85:{33,45,47}, src/main/scala/chisel3/util/Decoupled.scala:52:35, src/main/scala/chisel3/util/OneHot.scala:58:35]
      if (_alloc_T) begin	// @[src/main/scala/chisel3/util/Decoupled.scala:52:35]
        if (a_first)	// @[generators/rocket-chip/src/main/scala/tilelink/Edges.scala:231:25]
          a_first_counter <= auto_anon_in_a_bits_opcode[2] ? 3'h0 : ~(_a_first_beats1_decode_T_1[5:3]);	// @[generators/rocket-chip/src/main/scala/tilelink/Edges.scala:92:37, :221:14, :229:27, generators/rocket-chip/src/main/scala/util/package.scala:243:{46,71,76}]
        else	// @[generators/rocket-chip/src/main/scala/tilelink/Edges.scala:231:25]
          a_first_counter <= a_first_counter - 3'h1;	// @[generators/rocket-chip/src/main/scala/tilelink/Edges.scala:229:27, :230:28]
      end
      if (_free_T) begin	// @[src/main/scala/chisel3/util/Decoupled.scala:52:35]
        if (d_last_counter == 3'h0)	// @[generators/rocket-chip/src/main/scala/tilelink/Edges.scala:229:27, :231:25]
          d_last_counter <= d_last_beats1;	// @[generators/rocket-chip/src/main/scala/tilelink/Edges.scala:221:14, :229:27]
        else	// @[generators/rocket-chip/src/main/scala/tilelink/Edges.scala:231:25]
          d_last_counter <= d_last_counter - 3'h1;	// @[generators/rocket-chip/src/main/scala/tilelink/Edges.scala:229:27, :230:28]
      end
    end
    if (a_first)	// @[generators/rocket-chip/src/main/scala/tilelink/Edges.scala:231:25]
      anonOut_a_bits_source_r <= {1'h0, |(nextFree_lo[15:8]), |(_nextFree_T_3[6:3]), |(_nextFree_T_5[2:1]), _nextFree_T_7};	// @[generators/rocket-chip/src/main/scala/tilelink/SourceShrinker.scala:60:53, generators/rocket-chip/src/main/scala/util/package.scala:88:63, src/main/scala/chisel3/util/OneHot.scala:30:18, :32:{10,14,28}]
  end // always @(posedge)
  `ifdef ENABLE_INITIAL_REG_
    `ifdef FIRRTL_BEFORE_INITIAL
      `FIRRTL_BEFORE_INITIAL
    `endif // FIRRTL_BEFORE_INITIAL
    logic [31:0] _RANDOM[0:0];
    initial begin
      `ifdef INIT_RANDOM_PROLOG_
        `INIT_RANDOM_PROLOG_
      `endif // INIT_RANDOM_PROLOG_
      `ifdef RANDOMIZE_REG_INIT
        _RANDOM[/*Zero width*/ 1'b0] = `RANDOM;
        allocated = _RANDOM[/*Zero width*/ 1'b0][15:0];	// @[generators/rocket-chip/src/main/scala/tilelink/SourceShrinker.scala:59:32]
        a_first_counter = _RANDOM[/*Zero width*/ 1'b0][18:16];	// @[generators/rocket-chip/src/main/scala/tilelink/Edges.scala:229:27, generators/rocket-chip/src/main/scala/tilelink/SourceShrinker.scala:59:32]
        d_last_counter = _RANDOM[/*Zero width*/ 1'b0][21:19];	// @[generators/rocket-chip/src/main/scala/tilelink/Edges.scala:229:27, generators/rocket-chip/src/main/scala/tilelink/SourceShrinker.scala:59:32]
        anonOut_a_bits_source_r = _RANDOM[/*Zero width*/ 1'b0][26:22];	// @[generators/rocket-chip/src/main/scala/tilelink/SourceShrinker.scala:59:32, generators/rocket-chip/src/main/scala/util/package.scala:88:63]
      `endif // RANDOMIZE_REG_INIT
    end // initial
    `ifdef FIRRTL_AFTER_INITIAL
      `FIRRTL_AFTER_INITIAL
    `endif // FIRRTL_AFTER_INITIAL
  `endif // ENABLE_INITIAL_REG_
  sourceIdMap_16x11 sourceIdMap_ext (	// @[generators/rocket-chip/src/main/scala/tilelink/SourceShrinker.scala:58:30]
    .R0_addr (auto_anon_out_d_bits_source),
    .R0_en   (1'h1),
    .R0_clk  (clock),
    .R0_data (auto_anon_in_d_bits_source),
    .W0_addr (_GEN),	// @[src/main/scala/chisel3/util/OneHot.scala:32:10]
    .W0_en   (a_first & _alloc_T),	// @[generators/rocket-chip/src/main/scala/tilelink/Edges.scala:231:25, generators/rocket-chip/src/main/scala/tilelink/SourceShrinker.scala:77:23, src/main/scala/chisel3/util/Decoupled.scala:52:35]
    .W0_clk  (clock),
    .W0_data (auto_anon_in_a_bits_source)
  );	// @[generators/rocket-chip/src/main/scala/tilelink/SourceShrinker.scala:58:30]
  assign auto_anon_in_a_ready = anonIn_a_ready;	// @[generators/rocket-chip/src/main/scala/tilelink/SourceShrinker.scala:68:35]
  assign auto_anon_in_d_valid = auto_anon_out_d_valid;
  assign auto_anon_in_d_bits_opcode = auto_anon_out_d_bits_opcode;
  assign auto_anon_in_d_bits_param = auto_anon_out_d_bits_param;
  assign auto_anon_in_d_bits_size = auto_anon_out_d_bits_size;
  assign auto_anon_in_d_bits_denied = auto_anon_out_d_bits_denied;
  assign auto_anon_in_d_bits_data = auto_anon_out_d_bits_data;
  assign auto_anon_in_d_bits_corrupt = auto_anon_out_d_bits_corrupt;
  assign auto_anon_out_a_valid = auto_anon_in_a_valid & ~block;	// @[generators/rocket-chip/src/main/scala/tilelink/SourceShrinker.scala:67:29, :68:38, :69:35]
  assign auto_anon_out_a_bits_opcode = auto_anon_in_a_bits_opcode;
  assign auto_anon_out_a_bits_param = auto_anon_in_a_bits_param;
  assign auto_anon_out_a_bits_size = auto_anon_in_a_bits_size;
  assign auto_anon_out_a_bits_source = a_first ? _GEN : anonOut_a_bits_source_r[3:0];	// @[generators/rocket-chip/src/main/scala/tilelink/Edges.scala:231:25, generators/rocket-chip/src/main/scala/util/package.scala:88:{42,63}, src/main/scala/chisel3/util/OneHot.scala:32:10]
  assign auto_anon_out_a_bits_address = auto_anon_in_a_bits_address;
  assign auto_anon_out_a_bits_mask = auto_anon_in_a_bits_mask;
  assign auto_anon_out_a_bits_data = auto_anon_in_a_bits_data;
  assign auto_anon_out_d_ready = auto_anon_in_d_ready;
endmodule

